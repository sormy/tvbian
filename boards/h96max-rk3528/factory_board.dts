/dts-v1/;

/* dt-bindings from rockchip-linux/kernel develop-6.1 (77168c8d5ab82399f65a80e9f807b50ba37cf483), include/ */
#include <dt-bindings/clock/rk3528-cru.h>
#include <dt-bindings/power/rk3528-power.h>
#include <dt-bindings/gpio/gpio.h>
#include <dt-bindings/interrupt-controller/arm-gic.h>
#include <dt-bindings/interrupt-controller/irq.h>
#include <dt-bindings/pinctrl/rockchip.h>
#include <dt-bindings/input/linux-event-codes.h>
#include <dt-bindings/thermal/thermal.h>

/ {
	compatible = "rockchip,rk3528-evb2-ddr3-v10", "rockchip,rk3528";
	interrupt-parent = <&gic>;
	#address-cells = <2>;
	#size-cells = <2>;
	model = "Rockchip RK3528 EVB2 DDR3 V10 Board";

	aliases {
		ethernet0 = "/ethernet@ffbd0000";
		ethernet1 = "/ethernet@ffbe0000";
		gpio0 = "/pinctrl/gpio@ff610000";
		gpio1 = "/pinctrl/gpio@ffaf0000";
		gpio2 = "/pinctrl/gpio@ffb00000";
		gpio3 = "/pinctrl/gpio@ffb10000";
		gpio4 = "/pinctrl/gpio@ffb20000";
		i2c0 = "/i2c@ffa50000";
		i2c1 = "/i2c@ffa58000";
		i2c2 = "/i2c@ffa60000";
		i2c3 = "/i2c@ffa68000";
		i2c4 = "/i2c@ffa70000";
		i2c5 = "/i2c@ffa78000";
		i2c6 = "/i2c@ffa80000";
		i2c7 = "/i2c@ffa88000";
		serial0 = "/serial@ff9f0000";
		serial1 = "/serial@ff9f8000";
		serial2 = "/serial@ffa00000";
		serial3 = "/serial@ffa08000";
		serial4 = "/serial@ffa10000";
		serial5 = "/serial@ffa18000";
		serial6 = "/serial@ffa20000";
		serial7 = "/serial@ffa28000";
		spi0 = "/spi@ff9c0000";
		spi1 = "/spi@ff9d0000";
		spi2 = "/spi@ffc00000";
	};

	clocks {
		compatible = "simple-bus";
		#address-cells = <2>;
		#size-cells = <2>;
		ranges;

		xin24m: xin24m {
			compatible = "fixed-clock";
			#clock-cells = <0>;
			clock-frequency = <24000000>;
			clock-output-names = "xin24m";
			phandle = <0x77>;
		};

		mclkin_sai0: mclkin-sai0 {
			compatible = "fixed-clock";
			#clock-cells = <0>;
			clock-frequency = <0>;
			clock-output-names = "i2s0_mclkin";
			phandle = <0x9b>;
		};

		mclkin_sai1: mclkin-sai1 {
			compatible = "fixed-clock";
			#clock-cells = <0>;
			clock-frequency = <0>;
			clock-output-names = "i2s1_mclkin";
			phandle = <0x9c>;
		};

		mclkout_sai0: mclkout-sai0@ff340014 {
			compatible = "rockchip,clk-out";
			reg = <0x00 0xff340014 0x00 0x04>;
			clocks = <&cru MCLK_SAI_I2S0>;
			#clock-cells = <0>;
			clock-output-names = "mclk_sai0_to_io";
			rockchip,bit-shift = <1>;
			rockchip,bit-set-to-disable;
			phandle = <0x9d>;
		};

		mclkout_sai1: mclkout-sai1@ff320004 {
			compatible = "rockchip,clk-out";
			reg = <0x00 0xff320004 0x00 0x04>;
			clocks = <&cru MCLK_SAI_I2S1>;
			#clock-cells = <0>;
			clock-output-names = "mclk_sai1_to_io";
			rockchip,bit-shift = <14>;
			rockchip,bit-set-to-disable;
			phandle = <0x9e>;
		};
	};

	cpus {
		#address-cells = <2>;
		#size-cells = <0>;

		cpu-map {

			cluster0 {

				core0 {
					cpu = <&cpu0>;
				};

				core1 {
					cpu = <&cpu1>;
				};

				core2 {
					cpu = <&cpu2>;
				};

				core3 {
					cpu = <&cpu3>;
				};
			};
		};

		cpu0: cpu@0 {
			device_type = "cpu";
			compatible = "arm,cortex-a53";
			reg = <0x00 0x00>;
			enable-method = "psci";
			clocks = <&scmi_clk SCMI_CLK_CPU>;
			#cooling-cells = <2>;
			dynamic-power-coefficient = <147>;
			operating-points-v2 = <&cpu0_opp_table>;
			cpu-idle-states = <&CPU_SLEEP0>;
			cpu-supply = <&vdd_cpu>;
			phandle = <0x03>;
		};

		cpu1: cpu@1 {
			device_type = "cpu";
			compatible = "arm,cortex-a53";
			reg = <0x00 0x01>;
			enable-method = "psci";
			clocks = <&scmi_clk SCMI_CLK_CPU>;
			operating-points-v2 = <&cpu0_opp_table>;
			cpu-idle-states = <&CPU_SLEEP0>;
			phandle = <0x04>;
		};

		cpu2: cpu@2 {
			device_type = "cpu";
			compatible = "arm,cortex-a53";
			reg = <0x00 0x02>;
			enable-method = "psci";
			clocks = <&scmi_clk SCMI_CLK_CPU>;
			operating-points-v2 = <&cpu0_opp_table>;
			cpu-idle-states = <&CPU_SLEEP1>;
			phandle = <0x05>;
		};

		cpu3: cpu@3 {
			device_type = "cpu";
			compatible = "arm,cortex-a53";
			reg = <0x00 0x03>;
			enable-method = "psci";
			clocks = <&scmi_clk SCMI_CLK_CPU>;
			operating-points-v2 = <&cpu0_opp_table>;
			cpu-idle-states = <&CPU_SLEEP1>;
			phandle = <0x06>;
		};

		idle-states {
			entry-method = "psci";

			CPU_SLEEP0: cpu-sleep0 {
				compatible = "arm,idle-state";
				local-timer-stop;
				arm,psci-suspend-param = <0x10000>;
				entry-latency-us = <120>;
				exit-latency-us = <250>;
				min-residency-us = <900>;
				status = "disabled";
				phandle = <0x09>;
			};

			CPU_SLEEP1: cpu-sleep {
				compatible = "arm,idle-state";
				local-timer-stop;
				arm,psci-suspend-param = <0x10000>;
				entry-latency-us = <120>;
				exit-latency-us = <250>;
				min-residency-us = <900>;
				status = "okay";
				phandle = <0x0b>;
			};
		};
	};

	cpu0_opp_table: cpu0-opp-table {
		compatible = "operating-points-v2";
		opp-shared;
		nvmem-cells = <&cpu_leakage>, <&cpu_opp_info>;
		nvmem-cell-names = "leakage", "opp-info";
		rockchip,video-4k-freq = <1200000>;
		rockchip,pvtm-voltage-sel = <0 1320 0 1321 1350 1 1351 1375 2 1376 1405 3 1406 1435 4 1436 1470 5 1471 1505 6 1506 1540 7 1541 1575 8 1576 1610 9 1611 1640 10 1641 9999 11>;
		rockchip,pvtm-pvtpll;
		rockchip,pvtm-offset = <0x18>;
		rockchip,pvtm-sample-time = <1100>;
		rockchip,pvtm-freq = <1608000>;
		rockchip,pvtm-volt = <900000>;
		rockchip,pvtm-ref-temp = <40>;
		rockchip,pvtm-temp-prop = <0x00 0x00>;
		rockchip,pvtm-thermal-zone = "soc-thermal";
		rockchip,grf = <&grf>;
		phandle = <0x08>;

		opp-408000000 {
			opp-hz = /bits/ 64 <408000000>;
			opp-microvolt = <825000 825000 1100000>;
			opp-microvolt-L0 = <862500 862500 1100000>;
			opp-microvolt-L1 = <862500 862500 1100000>;
			opp-microvolt-L2 = <862500 862500 1100000>;
			opp-microvolt-L3 = <862500 862500 1100000>;
			opp-microvolt-L4 = <862500 862500 1100000>;
			opp-microvolt-L5 = <837500 837500 1100000>;
			clock-latency-ns = <40000>;
			opp-suspend;
		};

		opp-600000000 {
			opp-hz = /bits/ 64 <600000000>;
			opp-microvolt = <825000 825000 1100000>;
			opp-microvolt-L0 = <862500 862500 1100000>;
			opp-microvolt-L1 = <862500 862500 1100000>;
			opp-microvolt-L2 = <862500 862500 1100000>;
			opp-microvolt-L3 = <862500 862500 1100000>;
			opp-microvolt-L4 = <862500 862500 1100000>;
			opp-microvolt-L5 = <837500 837500 1100000>;
			clock-latency-ns = <40000>;
		};

		opp-816000000 {
			opp-hz = /bits/ 64 <816000000>;
			opp-microvolt = <825000 825000 1100000>;
			opp-microvolt-L0 = <862500 862500 1100000>;
			opp-microvolt-L1 = <862500 862500 1100000>;
			opp-microvolt-L2 = <862500 862500 1100000>;
			opp-microvolt-L3 = <862500 862500 1100000>;
			opp-microvolt-L4 = <862500 862500 1100000>;
			opp-microvolt-L5 = <837500 837500 1100000>;
			clock-latency-ns = <40000>;
		};

		opp-1008000000 {
			opp-hz = /bits/ 64 <1008000000>;
			opp-microvolt = <825000 825000 1100000>;
			opp-microvolt-L0 = <862500 862500 1100000>;
			opp-microvolt-L1 = <862500 862500 1100000>;
			opp-microvolt-L2 = <862500 862500 1100000>;
			opp-microvolt-L3 = <862500 862500 1100000>;
			opp-microvolt-L4 = <862500 862500 1100000>;
			opp-microvolt-L5 = <837500 837500 1100000>;
			clock-latency-ns = <40000>;
		};

		opp-1200000000 {
			opp-hz = /bits/ 64 <1200000000>;
			opp-microvolt = <825000 825000 1100000>;
			opp-microvolt-L0 = <900000 900000 1100000>;
			opp-microvolt-L1 = <887500 887500 1100000>;
			opp-microvolt-L2 = <875000 875000 1100000>;
			opp-microvolt-L3 = <875000 875000 1100000>;
			opp-microvolt-L4 = <862500 862500 1100000>;
			opp-microvolt-L5 = <850000 850000 1100000>;
			opp-microvolt-L6 = <837500 837500 1100000>;
			clock-latency-ns = <40000>;
		};

		opp-1416000000 {
			opp-hz = /bits/ 64 <1416000000>;
			opp-microvolt = <962500 962500 1100000>;
			opp-microvolt-L1 = <950000 950000 1100000>;
			opp-microvolt-L2 = <950000 950000 1100000>;
			opp-microvolt-L3 = <937500 937500 1100000>;
			opp-microvolt-L4 = <925000 925000 1100000>;
			opp-microvolt-L5 = <912500 912500 1100000>;
			opp-microvolt-L6 = <900000 900000 1100000>;
			opp-microvolt-L7 = <887500 887000 1100000>;
			opp-microvolt-L8 = <875000 875000 1100000>;
			opp-microvolt-L9 = <862500 862500 1100000>;
			opp-microvolt-L10 = <850000 850000 1100000>;
			opp-microvolt-L11 = <850000 850000 1100000>;
			clock-latency-ns = <40000>;
		};

		opp-1608000000 {
			opp-hz = /bits/ 64 <1608000000>;
			opp-microvolt = <1012500 1012500 1100000>;
			opp-microvolt-L2 = <1000000 1000000 1100000>;
			opp-microvolt-L3 = <987500 987500 1100000>;
			opp-microvolt-L4 = <975000 975000 1100000>;
			opp-microvolt-L5 = <962500 962500 1100000>;
			opp-microvolt-L6 = <950000 950000 1100000>;
			opp-microvolt-L7 = <937500 937500 1100000>;
			opp-microvolt-L8 = <925000 925000 1100000>;
			opp-microvolt-L9 = <912500 912500 1100000>;
			opp-microvolt-L10 = <900000 900000 1100000>;
			opp-microvolt-L11 = <887500 887500 1100000>;
			clock-latency-ns = <40000>;
		};

		opp-1800000000 {
			opp-hz = /bits/ 64 <1800000000>;
			opp-microvolt = <1062500 1062500 1100000>;
			opp-microvolt-L1 = <1050000 1050000 1100000>;
			opp-microvolt-L2 = <1037500 1037500 1100000>;
			opp-microvolt-L3 = <1025000 1025000 1100000>;
			opp-microvolt-L4 = <1012500 1012500 1100000>;
			opp-microvolt-L5 = <1000000 1000000 1100000>;
			opp-microvolt-L6 = <987500 987500 1100000>;
			opp-microvolt-L7 = <975000 975000 1100000>;
			opp-microvolt-L8 = <962500 962500 1100000>;
			opp-microvolt-L9 = <950000 950000 1100000>;
			opp-microvolt-L10 = <937500 937500 1100000>;
			opp-microvolt-L11 = <925000 925000 1100000>;
			clock-latency-ns = <40000>;
		};

		opp-2016000000 {
			opp-hz = /bits/ 64 <2016000000>;
			opp-microvolt = <1100000 1100000 1100000>;
			opp-microvolt-L1 = <1087500 1087500 1100000>;
			opp-microvolt-L2 = <1075000 1075000 1100000>;
			opp-microvolt-L3 = <1062500 1062500 1100000>;
			opp-microvolt-L4 = <1050000 1050000 1100000>;
			opp-microvolt-L5 = <1037500 1037500 1100000>;
			opp-microvolt-L6 = <1025000 1025000 1100000>;
			opp-microvolt-L7 = <1012500 1012500 1100000>;
			opp-microvolt-L8 = <1000000 1000000 1100000>;
			opp-microvolt-L9 = <987500 987500 1100000>;
			opp-microvolt-L10 = <975000 975000 1100000>;
			opp-microvolt-L11 = <962500 962500 1100000>;
			clock-latency-ns = <40000>;
		};
	};

	arm-pmu {
		compatible = "arm,cortex-a53-pmu";
		interrupts = <GIC_SPI 171 IRQ_TYPE_LEVEL_HIGH>,
		             <GIC_SPI 172 IRQ_TYPE_LEVEL_HIGH>,
		             <GIC_SPI 173 IRQ_TYPE_LEVEL_HIGH>,
		             <GIC_SPI 174 IRQ_TYPE_LEVEL_HIGH>;
		interrupt-affinity = <&cpu0>, <&cpu1>, <&cpu2>, <&cpu3>;
	};

	cpuinfo {
		compatible = "rockchip,cpuinfo";
		nvmem-cells = <&otp_id>, <&otp_cpu_version>, <&cpu_code>;
		nvmem-cell-names = "id", "cpu-version", "cpu-code";
	};

	display_subsystem: display-subsystem {
		compatible = "rockchip,display-subsystem";
		ports = <&vop_out>;
		status = "okay";
		memory-region = <&drm_logo>, <&drm_cubic_lut>;
		memory-region-names = "drm-logo", "drm-cubic-lut";
		phandle = <0x9f>;

		route {

			route_hdmi: route-hdmi {
				status = "okay";
				logo,uboot = "logo.bmp";
				logo,mode = "fullscreen";
				charge_logo,mode = "center";
				connect = <&vp0_out_hdmi>;
				phandle = <0xa0>;
			};

			route_tve: route-tve {
				status = "okay";
				logo,uboot = "logo.bmp";
				logo,mode = "fullscreen";
				charge_logo,mode = "center";
				connect = <&vp1_out_tve>;
				phandle = <0xa1>;
			};
		};
	};

	dmc: dmc {
		compatible = "rockchip,rk3528-dmc";
		clocks = <&scmi_clk SCMI_CLK_DDR>;
		clock-names = "dmc_clk";
		operating-points-v2 = <&dmc_opp_table>;
		status = "okay";
		center-supply = <&vdd_logic>;
		phandle = <0xa2>;
	};

	dmc_opp_table: dmc-opp-table {
		compatible = "operating-points-v2";
		nvmem-cells = <&log_leakage>, <&dmc_opp_info>;
		nvmem-cell-names = "leakage", "opp-info";
		rockchip,temp-hysteresis = <5000>;
		rockchip,low-temp = <10000>;
		rockchip,low-temp-min-volt = <900000>;
		rockchip,leakage-voltage-sel = <1 10 0 11 14 1 15 22 2 23 28 3 29 254 4>;
		phandle = <0x17>;

		opp-920000000 {
			opp-hz = /bits/ 64 <920000000>;
			opp-microvolt = <850000 850000 1000000>;
		};

		opp-1056000000 {
			opp-hz = /bits/ 64 <1056000000>;
			opp-microvolt = <850000 850000 1000000>;
			opp-microvolt-L0 = <875000 875000 1000000>;
			opp-microvolt-L1 = <850000 850000 1000000>;
			opp-microvolt-L2 = <850000 850000 1000000>;
			opp-microvolt-L3 = <850000 850000 1000000>;
			opp-microvolt-L4 = <850000 850000 1000000>;
		};

		opp-1184000000 {
			opp-hz = /bits/ 64 <1184000000>;
			opp-microvolt = <900000 900000 1000000>;
			opp-microvolt-L0 = <950000 950000 1000000>;
			opp-microvolt-L1 = <925000 925000 1000000>;
			opp-microvolt-L2 = <900000 900000 1000000>;
			opp-microvolt-L3 = <875000 875000 1000000>;
			opp-microvolt-L4 = <862500 862500 1000000>;
			status = "disabled";
		};
	};

	firmware {

		scmi: scmi {
			compatible = "arm,scmi-smc";
			shmem = <&scmi_shmem>;
			arm,smc-id = <0x82000010>;
			#address-cells = <1>;
			#size-cells = <0>;
			phandle = <0xa3>;

			scmi_clk: protocol@14 {
				reg = <0x14>;
				#clock-cells = <1>;
				assigned-clocks = <&scmi_clk SCMI_CLK_CPU>;
				assigned-clock-rates = <1200000000>;
				phandle = <0x07>;
			};
		};

		optee {
			compatible = "linaro,optee-tz";
			method = "smc";
		};
	};

	mpp_srv: mpp-srv {
		compatible = "rockchip,mpp-service";
		rockchip,taskqueue-count = <5>;
		rockchip,resetgroup-count = <5>;
		status = "okay";
		phandle = <0x2d>;
	};

	psci {
		compatible = "arm,psci-1.0";
		method = "smc";
	};

	rkvtunnel: rkvtunnel {
		compatible = "rockchip,video-tunnel";
		status = "okay";
		phandle = <0xa4>;
	};

	rockchip_suspend: rockchip-suspend {
		compatible = "rockchip,pm-rk3528";
		status = "okay";
		rockchip,sleep-debug-en = <0x01>;
		rockchip,sleep-mode-config = <0x01>;
		rockchip,wakeup-config = <0x11>;
		rockchip,virtual-poweroff = <0x01>;
		rockchip,pwm-regulator-config = <0x03>;
		phandle = <0xa5>;
	};

	rockchip_system_monitor: rockchip-system-monitor {
		compatible = "rockchip,system-monitor";
		rockchip,thermal-zone = "soc-thermal";
		rockchip,polling-delay = <200>;
		rockchip,temp-hysteresis = <5000>;
		rockchip,offline-cpu-temp = <105000>;
		rockchip,temp-offline-cpus = "2-3";
		phandle = <0xa6>;
	};

	thermal_zones: thermal-zones {
		phandle = <0xa7>;

		soc_thermal: soc-thermal {
			polling-delay-passive = <20>;
			polling-delay = <1000>;
			sustainable-power = <638>;
			thermal-sensors = <&tsadc 0>;
			phandle = <0xa8>;

			trips {

				threshold: trip-point-0 {
					temperature = <95000>;
					hysteresis = <2000>;
					type = "passive";
					phandle = <0xa9>;
				};

				target: trip-point-1 {
					temperature = <110000>;
					hysteresis = <2000>;
					type = "passive";
					phandle = <0x1d>;
				};

				soc_crit: soc-crit {
					temperature = <120000>;
					hysteresis = <2000>;
					type = "critical";
					phandle = <0xaa>;
				};
			};

			cooling-maps {

				map0 {
					trip = <&target>;
					cooling-device = <&cpu0 THERMAL_NO_LIMIT THERMAL_NO_LIMIT>;
					contribution = <1024>;
				};

				map1 {
					trip = <&target>;
					cooling-device = <&gpu THERMAL_NO_LIMIT THERMAL_NO_LIMIT>;
					contribution = <1024>;
				};
			};
		};
	};

	timer {
		compatible = "arm,armv8-timer";
		interrupts = <GIC_PPI 13 (GIC_CPU_MASK_SIMPLE(4) | IRQ_TYPE_LEVEL_LOW)>,
		             <GIC_PPI 14 (GIC_CPU_MASK_SIMPLE(4) | IRQ_TYPE_LEVEL_LOW)>,
		             <GIC_PPI 11 (GIC_CPU_MASK_SIMPLE(4) | IRQ_TYPE_LEVEL_LOW)>,
		             <GIC_PPI 10 (GIC_CPU_MASK_SIMPLE(4) | IRQ_TYPE_LEVEL_LOW)>;
	};

	scmi_shmem: scmi-shmem@10f000 {
		compatible = "arm,scmi-shmem";
		reg = <0x00 0x10f000 0x00 0x100>;
		phandle = <0x1b>;
	};

	sram: sram@fe480000 {
		compatible = "mmio-sram";
		reg = <0x00 0xfe480000 0x00 0xc000>;
		#address-cells = <1>;
		#size-cells = <1>;
		ranges = <0x00 0x00 0xfe480000 0xc000>;
		phandle = <0xab>;

		rkvdec_sram: rkvdec-sram@0 {
			reg = <0x00 0xc000>;
			phandle = <0x2e>;
		};
	};

	pcie2x1: pcie@fe4f0000 {
		compatible = "rockchip,rk3528-pcie", "snps,dw-pcie";
		#address-cells = <3>;
		#size-cells = <2>;
		bus-range = <0x00 0xff>;
		clocks = <&cru ACLK_PCIE>,
		         <&cru HCLK_PCIE_SLV>,
		         <&cru HCLK_PCIE_DBI>,
		         <&cru PCLK_CRU_PCIE>,
		         <&cru CLK_PCIE_AUX>,
		         <&cru PCLK_PCIE>,
		         <&cru PCLK_PCIE_PHY>;
		clock-names = "aclk", "hclk_slv", "hclk_dbi", "pclk_cru", "aux", "pclk", "pipe";
		device_type = "pci";
		interrupts = <GIC_SPI 158 IRQ_TYPE_LEVEL_HIGH>,
		             <GIC_SPI 157 IRQ_TYPE_LEVEL_HIGH>,
		             <GIC_SPI 156 IRQ_TYPE_LEVEL_HIGH>,
		             <GIC_SPI 155 IRQ_TYPE_LEVEL_HIGH>,
		             <GIC_SPI 154 IRQ_TYPE_LEVEL_HIGH>,
		             <GIC_SPI 153 IRQ_TYPE_LEVEL_HIGH>;
		interrupt-names = "msi", "pmc", "sys", "legacy", "msg", "err";
		#interrupt-cells = <1>;
		interrupt-map-mask = <0x00 0x00 0x00 0x07>;
		interrupt-map = <0x00 0x00 0x00 0x01 0x1f 0x00 0x00 0x00 0x00 0x02 0x1f 0x01 0x00 0x00 0x00 0x03 0x1f 0x02 0x00 0x00 0x00 0x04 0x1f 0x03>;
		linux,pci-domain = <0x00>;
		num-ib-windows = <0x08>;
		num-ob-windows = <0x08>;
		num-viewport = <0x04>;
		max-link-speed = <0x02>;
		num-lanes = <0x01>;
		phys = <&combphy_pu 2>;
		phy-names = "pcie-phy";
		ranges = <0x800 0x00 0xfc000000 0x00 0xfc000000 0x00 0x100000 0x81000000 0x00 0xfc100000 0x00 0xfc100000 0x00 0x100000 0x82000000 0x00 0xfc200000 0x00 0xfc200000 0x00 0x1e00000 0xc3000000 0x01 0x00 0x01 0x00 0x00 0x40000000>;
		reg = <0x00 0xfe4f0000 0x00 0x10000>, <0x01 0x40000000 0x00 0x400000>;
		reg-names = "pcie-apb", "pcie-dbi";
		resets = <&cru SRST_RESETN_PCIE_POWER_UP>,
		         <&cru SRST_PRESETN_PCIE>,
		         <&cru SRST_PRESETN_CRU_PCIE>;
		reset-names = "pcie", "periph", "preset_cru";
		status = "disabled";
		phandle = <0xac>;

		pcie2x1_intc: legacy-interrupt-controller {
			interrupt-controller;
			#address-cells = <0>;
			#interrupt-cells = <1>;
			interrupt-parent = <&gic>;
			interrupts = <GIC_SPI 155 IRQ_TYPE_EDGE_RISING>;
			phandle = <0x1f>;
		};
	};

	usbdrd30: usbdrd {
		compatible = "rockchip,rk3528-dwc3", "rockchip,rk3399-dwc3";
		clocks = <&cru CLK_REF_USB3OTG>, <&cru CLK_SUSPEND_USB3OTG>, <&cru ACLK_USB3OTG>;
		clock-names = "ref_clk", "suspend_clk", "bus_clk";
		#address-cells = <2>;
		#size-cells = <2>;
		ranges;
		status = "okay";
		phandle = <0xad>;

		usbdrd_dwc3: dwc3@fe500000 {
			compatible = "snps,dwc3";
			reg = <0x00 0xfe500000 0x00 0x400000>;
			interrupts = <GIC_SPI 152 IRQ_TYPE_LEVEL_HIGH>;
			dr_mode = "host";
			phys = <&u2phy_otg>;
			phy-names = "usb2-phy";
			phy_type = "utmi_wide";
			resets = <&cru SRST_ARESETN_USB3OTG>;
			reset-names = "usb3-otg";
			snps,dis_enblslpm_quirk;
			snps,dis-u1u2-quirk;
			snps,dis-u2-freeclk-exists-quirk;
			snps,dis-del-phy-power-chg-quirk;
			snps,dis-tx-ipgap-linecheck-quirk;
			snps,xhci-trb-ent-quirk;
			snps,dis_rxdet_inp3_quirk;
			quirk-skip-phy-init;
			status = "okay";
			extcon = <&usb2phy>;
			maximum-speed = "high-speed";
			snps,dis_u2_susphy_quirk;
			snps,usb2-lpm-disable;
			phandle = <0xae>;
		};
	};

	gic: interrupt-controller@fed01000 {
		compatible = "arm,gic-400";
		#interrupt-cells = <3>;
		#address-cells = <0>;
		interrupt-controller;
		reg = <0x00 0xfed01000 0x00 0x1000 0x00 0xfed02000 0x00 0x2000 0x00 0xfed04000 0x00 0x2000 0x00 0xfed06000 0x00 0x2000>;
		interrupts = <GIC_PPI 9 (GIC_CPU_MASK_SIMPLE(4) | IRQ_TYPE_LEVEL_LOW)>;
		phandle = <0x01>;
	};

	usb_host0_ehci: usb@ff100000 {
		compatible = "generic-ehci";
		reg = <0x00 0xff100000 0x00 0x40000>;
		interrupts = <GIC_SPI 143 IRQ_TYPE_LEVEL_HIGH>;
		clocks = <&cru HCLK_USBHOST>, <&cru HCLK_USBHOST_ARB>, <&usb2phy>;
		clock-names = "usbhost", "arbiter", "utmi";
		phys = <&u2phy_host>;
		phy-names = "usb2-phy";
		status = "okay";
		phandle = <0xaf>;
	};

	usb_host0_ohci: usb@ff140000 {
		compatible = "generic-ohci";
		reg = <0x00 0xff140000 0x00 0x40000>;
		interrupts = <GIC_SPI 144 IRQ_TYPE_LEVEL_HIGH>;
		clocks = <&cru HCLK_USBHOST>, <&cru HCLK_USBHOST_ARB>, <&usb2phy>;
		clock-names = "usbhost", "arbiter", "utmi";
		phys = <&u2phy_host>;
		phy-names = "usb2-phy";
		status = "okay";
		phandle = <0xb0>;
	};

	debug: debug@ff190000 {
		compatible = "rockchip,debug";
		reg = <0x00 0xff190000 0x00 0x1000 0x00 0xff192000 0x00 0x1000 0x00 0xff194000 0x00 0x1000 0x00 0xff196000 0x00 0x1000>;
		phandle = <0xb1>;
	};

	qos_crypto_a: qos@ff200000 {
		compatible = "syscon";
		reg = <0x00 0xff200000 0x00 0x20>;
		phandle = <0xb2>;
	};

	qos_crypto_p: qos@ff200080 {
		compatible = "syscon";
		reg = <0x00 0xff200080 0x00 0x20>;
		phandle = <0xb3>;
	};

	qos_dcf: qos@ff200100 {
		compatible = "syscon";
		reg = <0x00 0xff200100 0x00 0x20>;
		phandle = <0xb4>;
	};

	qos_dft2apb: qos@ff200200 {
		compatible = "syscon";
		reg = <0x00 0xff200200 0x00 0x20>;
		phandle = <0xb5>;
	};

	qos_dma2ddr: qos@ff200280 {
		compatible = "syscon";
		reg = <0x00 0xff200280 0x00 0x20>;
		phandle = <0xb6>;
	};

	qos_dmac: qos@ff200300 {
		compatible = "syscon";
		reg = <0x00 0xff200300 0x00 0x20>;
		phandle = <0xb7>;
	};

	qos_keyreader: qos@ff200380 {
		compatible = "syscon";
		reg = <0x00 0xff200380 0x00 0x20>;
		phandle = <0xb8>;
	};

	qos_cpu: qos@ff210000 {
		compatible = "syscon";
		reg = <0x00 0xff210000 0x00 0x20>;
		phandle = <0xb9>;
	};

	qos_debug: qos@ff210080 {
		compatible = "syscon";
		reg = <0x00 0xff210080 0x00 0x20>;
		phandle = <0xba>;
	};

	qos_gpu_m0: qos@ff220000 {
		compatible = "syscon";
		reg = <0x00 0xff220000 0x00 0x20>;
		phandle = <0x24>;
	};

	qos_gpu_m1: qos@ff220080 {
		compatible = "syscon";
		reg = <0x00 0xff220080 0x00 0x20>;
		phandle = <0x25>;
	};

	qos_pmu_mcu: qos@ff240000 {
		compatible = "syscon";
		reg = <0x00 0xff240000 0x00 0x20>;
		phandle = <0xbb>;
	};

	qos_rkvdec: qos@ff250000 {
		compatible = "syscon";
		reg = <0x00 0xff250000 0x00 0x20>;
		phandle = <0xbc>;
	};

	qos_rkvenc: qos@ff260000 {
		compatible = "syscon";
		reg = <0x00 0xff260000 0x00 0x20>;
		phandle = <0xbd>;
	};

	qos_gmac0: qos@ff270000 {
		compatible = "syscon";
		reg = <0x00 0xff270000 0x00 0x20>;
		phandle = <0xbe>;
	};

	qos_hdcp: qos@ff270080 {
		compatible = "syscon";
		reg = <0x00 0xff270080 0x00 0x20>;
		phandle = <0xbf>;
	};

	qos_jpegdec: qos@ff270100 {
		compatible = "syscon";
		reg = <0x00 0xff270100 0x00 0x20>;
		phandle = <0xc0>;
	};

	qos_rga2_m0ro: qos@ff270200 {
		compatible = "syscon";
		reg = <0x00 0xff270200 0x00 0x20>;
		phandle = <0xc1>;
	};

	qos_rga2_m0wo: qos@ff270280 {
		compatible = "syscon";
		reg = <0x00 0xff270280 0x00 0x20>;
		phandle = <0xc2>;
	};

	qos_sdmmc0: qos@ff270300 {
		compatible = "syscon";
		reg = <0x00 0xff270300 0x00 0x20>;
		phandle = <0xc3>;
	};

	qos_usb2host: qos@ff270380 {
		compatible = "syscon";
		reg = <0x00 0xff270380 0x00 0x20>;
		phandle = <0xc4>;
	};

	qos_vdpp: qos@ff270480 {
		compatible = "syscon";
		reg = <0x00 0xff270480 0x00 0x20>;
		phandle = <0xc5>;
	};

	qos_vop: qos@ff270500 {
		compatible = "syscon";
		reg = <0x00 0xff270500 0x00 0x20>;
		phandle = <0xc6>;
	};

	qos_emmc: qos@ff280000 {
		compatible = "syscon";
		reg = <0x00 0xff280000 0x00 0x20>;
		phandle = <0xc7>;
	};

	qos_fspi: qos@ff280080 {
		compatible = "syscon";
		reg = <0x00 0xff280080 0x00 0x20>;
		phandle = <0xc8>;
	};

	qos_gmac1: qos@ff280100 {
		compatible = "syscon";
		reg = <0x00 0xff280100 0x00 0x20>;
		phandle = <0xc9>;
	};

	qos_pcie: qos@ff280180 {
		compatible = "syscon";
		reg = <0x00 0xff280180 0x00 0x20>;
		phandle = <0xca>;
	};

	qos_sdio0: qos@ff280200 {
		compatible = "syscon";
		reg = <0x00 0xff280200 0x00 0x20>;
		phandle = <0xcb>;
	};

	qos_sdio1: qos@ff280280 {
		compatible = "syscon";
		reg = <0x00 0xff280280 0x00 0x20>;
		phandle = <0xcc>;
	};

	qos_tsp: qos@ff280300 {
		compatible = "syscon";
		reg = <0x00 0xff280300 0x00 0x20>;
		phandle = <0xcd>;
	};

	qos_usb3otg: qos@ff280380 {
		compatible = "syscon";
		reg = <0x00 0xff280380 0x00 0x20>;
		phandle = <0xce>;
	};

	qos_vpu: qos@ff280400 {
		compatible = "syscon";
		reg = <0x00 0xff280400 0x00 0x20>;
		phandle = <0xcf>;
	};

	grf: syscon@ff300000 {
		compatible = "rockchip,rk3528-grf", "syscon", "simple-mfd";
		reg = <0x00 0xff300000 0x00 0x90000>;
		phandle = <0x0e>;

		grf_cru: grf-clock-controller {
			compatible = "rockchip,rk3528-grf-cru";
			#clock-cells = <1>;
			phandle = <0x6a>;
		};

		reboot_mode: reboot-mode {
			compatible = "syscon-reboot-mode";
			offset = <0x70200>;
			mode-bootloader = <0x5242c301>;
			mode-charge = <0x5242c30b>;
			mode-fastboot = <0x5242c309>;
			mode-loader = <0x5242c301>;
			mode-normal = <0x5242c300>;
			mode-recovery = <0x5242c303>;
			mode-ums = <0x5242c30c>;
			mode-panic = <0x5242c307>;
			mode-watchdog = <0x5242c308>;
			phandle = <0xd0>;
		};
	};

	cru: clock-controller@ff4a0000 {
		compatible = "rockchip,rk3528-cru";
		reg = <0x00 0xff4a0000 0x00 0x30000>;
		rockchip,grf = <&grf>;
		#clock-cells = <1>;
		#reset-cells = <1>;
		assigned-clocks = <&cru XIN_OSC0_DIV>,
		                  <&cru SCLK_SDIO0_DRV>,
		                  <&cru SCLK_SDIO0_SAMPLE>,
		                  <&cru SCLK_SDMMC_SAMPLE>,
		                  <&cru CLK_MATRIX_250M_SRC>,
		                  <&cru CLK_MATRIX_500M_SRC>,
		                  <&cru CLK_MATRIX_50M_SRC>,
		                  <&cru CLK_MATRIX_100M_SRC>,
		                  <&cru CLK_MATRIX_150M_SRC>,
		                  <&cru CLK_MATRIX_200M_SRC>,
		                  <&cru CLK_MATRIX_300M_SRC>,
		                  <&cru CLK_MATRIX_339M_SRC>,
		                  <&cru CLK_MATRIX_400M_SRC>,
		                  <&cru CLK_MATRIX_600M_SRC>,
		                  <&cru CLK_PPLL_50M_MATRIX>,
		                  <&cru CLK_PPLL_100M_MATRIX>,
		                  <&cru CLK_PPLL_125M_MATRIX>,
		                  <&cru ACLK_BUS_VOPGL_ROOT>,
		                  <&cru ACLK_VO_ROOT>,
		                  <&cru ACLK_VPU_ROOT>,
		                  <&cru ACLK_VPU_L_ROOT>;
		assigned-clock-rates = <32768>,
		                       <1188000000>,
		                       <1000000000>,
		                       <996000000>,
		                       <250000000>,
		                       <500000000>,
		                       <50000000>,
		                       <100000000>,
		                       <150000000>,
		                       <200000000>,
		                       <300000000>,
		                       <340000000>,
		                       <400000000>,
		                       <600000000>,
		                       <50000000>,
		                       <100000000>,
		                       <125000000>,
		                       <500000000>,
		                       <340000000>,
		                       <300000000>,
		                       <200000000>;
		phandle = <0x02>;
	};

	ioc_grf: syscon@ff540000 {
		compatible = "rockchip,rk3528-ioc-grf", "syscon";
		reg = <0x00 0xff540000 0x00 0x40000>;
		phandle = <0x78>;
	};

	pmu: power-management@ff600000 {
		compatible = "rockchip,rk3528-pmu", "syscon", "simple-mfd";
		reg = <0x00 0xff600000 0x00 0x2000>;
		phandle = <0xd1>;

		power: power-controller {
			compatible = "rockchip,rk3528-power-controller";
			#power-domain-cells = <1>;
			#address-cells = <1>;
			#size-cells = <0>;
			status = "okay";
			phandle = <0x26>;

			pd_gpu@4 {
				reg = <0x04>;
				clocks = <&cru ACLK_GPU_MALI>, <&cru PCLK_GPU_ROOT>;
				pm_qos = <&qos_gpu_m0>, <&qos_gpu_m1>;
			};

			pd_rkvdec@5 {
				reg = <0x05>;
			};

			pd_rkvenc@6 {
				reg = <0x06>;
			};

			pd_vo@7 {
				reg = <0x07>;
			};

			pd_vpu@8 {
				reg = <0x08>;
			};
		};
	};

	mailbox: mailbox@ff630000 {
		compatible = "rockchip,rk3528-mailbox", "rockchip,rk3368-mailbox";
		reg = <0x00 0xff630000 0x00 0x200>;
		interrupts = <GIC_SPI 60 IRQ_TYPE_LEVEL_HIGH>;
		clocks = <&cru PCLK_PMU_MAILBOX>;
		clock-names = "pclk_mailbox";
		#mbox-cells = <1>;
		status = "disabled";
		phandle = <0xd2>;
	};

	gpu: gpu@ff700000 {
		compatible = "arm,mali-450";
		reg = <0x00 0xff700000 0x00 0x40000>;
		interrupts = <GIC_SPI 88 IRQ_TYPE_LEVEL_HIGH>,
		             <GIC_SPI 89 IRQ_TYPE_LEVEL_HIGH>,
		             <GIC_SPI 86 IRQ_TYPE_LEVEL_HIGH>,
		             <GIC_SPI 92 IRQ_TYPE_LEVEL_HIGH>,
		             <GIC_SPI 93 IRQ_TYPE_LEVEL_HIGH>,
		             <GIC_SPI 90 IRQ_TYPE_LEVEL_HIGH>,
		             <GIC_SPI 91 IRQ_TYPE_LEVEL_HIGH>;
		interrupt-names = "Mali_GP_IRQ", "Mali_GP_MMU_IRQ", "IRQPP", "Mali_PP0_IRQ", "Mali_PP0_MMU_IRQ", "Mali_PP1_IRQ", "Mali_PP1_MMU_IRQ";
		clocks = <&scmi_clk SCMI_CLK_GPU>, <&cru ACLK_GPU_MALI>, <&cru PCLK_GPU_ROOT>;
		clock-names = "clk_mali", "aclk_gpu_mali", "pclk_gpu";
		assigned-clocks = <&scmi_clk SCMI_CLK_GPU>;
		assigned-clock-rates = <300000000>;
		power-domains = <&power RK3528_PD_GPU>;
		operating-points-v2 = <&gpu_opp_table>;
		#cooling-cells = <2>;
		rockchip,grf = <&grf>;
		status = "okay";
		mali-supply = <&vdd_gpu>;
		phandle = <0x1e>;

		gpu_power_model: power-model {
			compatible = "simple-power-model";
			leakage-range = <1 3>;
			ls = <0xffffc2d6 0x1071a 0x00>;
			static-coefficient = <10000>;
			dynamic-coefficient = <724>;
			ts = <0x302a42 0x1d55a 0xfffff636 0x27>;
			thermal-zone = "soc-thermal";
			phandle = <0xd3>;
		};
	};

	gpu_opp_table: gpu-opp-table {
		compatible = "operating-points-v2";
		nvmem-cells = <&gpu_leakage>, <&gpu_opp_info>;
		nvmem-cell-names = "leakage", "opp-info";
		rockchip,pvtm-voltage-sel = <0 750 0 751 770 1 771 790 2 791 810 3 811 830 4 831 850 5 851 870 6 871 890 7 891 9999 8>;
		rockchip,pvtm-pvtpll;
		rockchip,pvtm-offset = <0x10018>;
		rockchip,pvtm-sample-time = <1100>;
		rockchip,pvtm-freq = "", "\f5";
		rockchip,pvtm-volt = <900000>;
		rockchip,pvtm-ref-temp = <40>;
		rockchip,pvtm-temp-prop = <0x00 0x00>;
		rockchip,pvtm-thermal-zone = "soc-thermal";
		rockchip,grf = <&grf>;
		phandle = <0x27>;

		opp-300000000 {
			opp-hz = /bits/ 64 <300000000>;
			opp-microvolt = <875000 875000 1000000>;
			opp-microvolt-L5 = <850000 850000 1000000>;
			opp-microvolt-L6 = <837500 837500 1000000>;
			opp-microvolt-L7 = <825000 825000 1000000>;
			opp-microvolt-L8 = <825000 825000 1000000>;
		};

		opp-500000000 {
			opp-hz = /bits/ 64 <500000000>;
			opp-microvolt = <875000 875000 1000000>;
			opp-microvolt-L5 = <850000 850000 1000000>;
			opp-microvolt-L6 = <837500 837500 1000000>;
			opp-microvolt-L7 = <825000 825000 1000000>;
			opp-microvolt-L8 = <825000 825000 1000000>;
		};

		opp-600000000 {
			opp-hz = /bits/ 64 <600000000>;
			opp-microvolt = <875000 875000 1000000>;
			opp-microvolt-L5 = <850000 850000 1000000>;
			opp-microvolt-L6 = <837500 837500 1000000>;
			opp-microvolt-L7 = <825000 825000 1000000>;
			opp-microvolt-L8 = <825000 825000 1000000>;
		};

		opp-700000000 {
			opp-hz = /bits/ 64 <700000000>;
			opp-microvolt = <900000 900000 1000000>;
			opp-microvolt-L1 = <887500 887500 1000000>;
			opp-microvolt-L2 = <875000 875000 1000000>;
			opp-microvolt-L3 = <875000 875000 1000000>;
			opp-microvolt-L4 = <875000 875000 1000000>;
			opp-microvolt-L5 = <850000 850000 1000000>;
			opp-microvolt-L6 = <837500 837500 1000000>;
			opp-microvolt-L7 = <825000 825000 1000000>;
			opp-microvolt-L8 = <825000 825000 1000000>;
			clock-latency-ns = <40000>;
		};

		opp-800000000 {
			opp-hz = /bits/ 64 <800000000>;
			opp-microvolt = <950000 950000 1000000>;
			opp-microvolt-L1 = <937500 937500 1000000>;
			opp-microvolt-L2 = <925000 925000 1000000>;
			opp-microvolt-L3 = <912500 912500 1000000>;
			opp-microvolt-L4 = <900000 900000 1000000>;
			opp-microvolt-L5 = <887500 887500 1000000>;
			opp-microvolt-L6 = <875000 875000 1000000>;
			opp-microvolt-L7 = <862500 862500 1000000>;
			opp-microvolt-L8 = <850000 850000 1000000>;
			clock-latency-ns = <40000>;
		};
	};

	gpu_bus: gpu-bus {
		compatible = "rockchip,rk3528-bus";
		rockchip,busfreq-policy = "clkfreq";
		clocks = <&scmi_clk SCMI_CLK_GPU>;
		clock-names = "bus";
		operating-points-v2 = <&gpu_bus_opp_table>;
		status = "okay";
		bus-supply = <&vdd_logic>;
		phandle = <0xd4>;
	};

	gpu_bus_opp_table: gpu-bus-opp-table {
		compatible = "operating-points-v2";
		nvmem-cells = <&log_leakage>;
		nvmem-cell-names = "leakage";
		rockchip,leakage-voltage-sel = <1 22 0 23 254 1>;
		phandle = <0x2b>;

		opp-700000000 {
			opp-hz = /bits/ 64 <700000000>;
			opp-microvolt = <850000 850000 1000000>;
		};

		opp-800000000 {
			opp-hz = /bits/ 64 <800000000>;
			opp-microvolt = <875000 875000 1000000>;
			opp-microvolt-L1 = <850000 850000 1000000>;
		};
	};

	rkvdec: rkvdec@ff740100 {
		compatible = "rockchip,rkv-decoder-rk3528", "rockchip,rkv-decoder-v2";
		reg = <0x00 0xff740100 0x00 0x400>, <0x00 0xff740000 0x00 0x100>;
		reg-names = "regs", "link";
		interrupts = <GIC_SPI 94 IRQ_TYPE_LEVEL_HIGH>;
		interrupt-names = "irq_dec";
		clocks = <&cru ACLK_RKVDEC>, <&cru HCLK_RKVDEC>, <&cru CLK_HEVC_CA_RKVDEC>;
		clock-names = "aclk_vcodec", "hclk_vcodec", "clk_hevc_cabac";
		rockchip,normal-rates = <340000000 0 600000000>;
		assigned-clocks = <&cru ACLK_RKVDEC>, <&cru CLK_HEVC_CA_RKVDEC>;
		assigned-clock-rates = <340000000>, <600000000>;
		resets = <&cru SRST_ARESETN_RKVDEC>,
		         <&cru SRST_HRESETN_RKVDEC>,
		         <&cru SRST_RESETN_HEVC_CA_RKVDEC>;
		reset-names = "video_a", "video_h", "video_hevc_cabac";
		iommus = <&rkvdec_mmu>;
		rockchip,srv = <&mpp_srv>;
		rockchip,taskqueue-node = <0>;
		rockchip,resetgroup-node = <0>;
		rockchip,task-capacity = <16>;
		rockchip,sram = <&rkvdec_sram>;
		rockchip,rcb-iova = <0x10000000 0x10000>;
		rockchip,rcb-min-width = <512>;
		status = "okay";
		phandle = <0xd5>;
	};

	rkvdec_mmu: iommu@ff740800 {
		compatible = "rockchip,iommu-v2";
		reg = <0x00 0xff740800 0x00 0x40 0x00 0xff740900 0x00 0x40>;
		interrupts = <GIC_SPI 95 IRQ_TYPE_LEVEL_HIGH>;
		interrupt-names = "rkvdec_mmu";
		clocks = <&cru ACLK_RKVDEC>, <&cru HCLK_RKVDEC>, <&cru CLK_HEVC_CA_RKVDEC>;
		clock-names = "aclk", "iface", "clk_hevc_cabac";
		#iommu-cells = <0>;
		rockchip,shootdown-entire;
		status = "okay";
		phandle = <0x2c>;
	};

	rkvenc: rkvenc@ff780000 {
		compatible = "rockchip,rkv-encoder-rk3528", "rockchip,rkv-encoder-v2";
		reg = <0x00 0xff780000 0x00 0x6000>;
		interrupts = <GIC_SPI 97 IRQ_TYPE_LEVEL_HIGH>;
		interrupt-names = "irq_rkvenc";
		clocks = <&cru ACLK_RKVENC>, <&cru HCLK_RKVENC>, <&cru CLK_CORE_RKVENC>;
		clock-names = "aclk_vcodec", "hclk_vcodec", "clk_core";
		rockchip,normal-rates = <300000000 0 300000000>;
		resets = <&cru SRST_ARESETN_RKVENC>,
		         <&cru SRST_HRESETN_RKVENC>,
		         <&cru SRST_RESETN_CORE_RKVENC>;
		reset-names = "video_a", "video_h", "video_core";
		assigned-clocks = <&cru ACLK_RKVENC>, <&cru CLK_CORE_RKVENC>;
		assigned-clock-rates = <300000000>, <300000000>;
		iommus = <&rkvenc_mmu>;
		rockchip,srv = <&mpp_srv>;
		rockchip,grf = <&grf>;
		rockchip,grf-mem-offset = <0x20010>;
		rockchip,grf-mem-values = <0x21 0xffff0021>;
		rockchip,taskqueue-node = <1>;
		rockchip,resetgroup-node = <1>;
		status = "okay";
		phandle = <0xd6>;
	};

	rkvenc_mmu: iommu@ff78f000 {
		compatible = "rockchip,iommu-v2";
		reg = <0x00 0xff78f000 0x00 0x40>;
		interrupts = <GIC_SPI 96 IRQ_TYPE_LEVEL_HIGH>;
		interrupt-names = "rkvenc_mmu";
		clocks = <&cru ACLK_RKVENC>, <&cru HCLK_RKVENC>;
		clock-names = "aclk", "iface";
		#iommu-cells = <0>;
		rockchip,shootdown-entire;
		status = "okay";
		phandle = <0x2f>;
	};

	vdpu: vdpu@ff7c0400 {
		compatible = "rockchip,vpu-decoder-v2";
		reg = <0x00 0xff7c0400 0x00 0x400>;
		interrupts = <GIC_SPI 98 IRQ_TYPE_LEVEL_HIGH>;
		interrupt-names = "irq_dec";
		clocks = <&cru ACLK_VPU>, <&cru HCLK_VPU>;
		clock-names = "aclk_vcodec", "hclk_vcodec";
		rockchip,normal-rates = <300000000 0>;
		assigned-clocks = <&cru ACLK_VPU>;
		assigned-clock-rates = <300000000>;
		resets = <&cru SRST_ARESETN_VPU>, <&cru SRST_HRESETN_VPU>;
		reset-names = "shared_video_a", "shared_video_h";
		iommus = <&vdpu_mmu>;
		rockchip,srv = <&mpp_srv>;
		rockchip,grf = <&grf>;
		rockchip,grf-mem-offset = <0x40034>;
		rockchip,grf-mem-values = <0xf040000 0xf040f04>;
		rockchip,taskqueue-node = <2>;
		rockchip,resetgroup-node = <2>;
		rockchip,disable-auto-freq;
		status = "okay";
		phandle = <0xd7>;
	};

	vdpu_mmu: iommu@ff7c0800 {
		compatible = "rockchip,iommu-v2";
		reg = <0x00 0xff7c0800 0x00 0x40>;
		interrupts = <GIC_SPI 99 IRQ_TYPE_LEVEL_HIGH>;
		interrupt-names = "vdpu_mmu";
		clock-names = "aclk", "iface";
		clocks = <&cru ACLK_VPU>, <&cru HCLK_VPU>;
		#iommu-cells = <0>;
		rockchip,shootdown-entire;
		status = "okay";
		phandle = <0x30>;
	};

	avsd: avsd_plus@ff7c1000 {
		compatible = "rockchip,avs-plus-decoder";
		reg = <0x00 0xff7c1000 0x00 0x200>;
		interrupts = <GIC_SPI 98 IRQ_TYPE_LEVEL_HIGH>;
		interrupt-names = "irq_dec";
		clocks = <&cru ACLK_VPU>, <&cru HCLK_VPU>;
		clock-names = "aclk_vcodec", "hclk_vcodec";
		rockchip,normal-rates = <300000000 0>;
		assigned-clocks = <&cru ACLK_VPU>;
		assigned-clock-rates = <300000000>;
		resets = <&cru SRST_ARESETN_VPU>, <&cru SRST_HRESETN_VPU>;
		reset-names = "shared_video_a", "shared_video_h";
		iommus = <&vdpu_mmu>;
		rockchip,srv = <&mpp_srv>;
		rockchip,taskqueue-node = <2>;
		rockchip,resetgroup-node = <2>;
		rockchip,disable-auto-freq;
		status = "okay";
		phandle = <0xd8>;
	};

	vop: vop@ff840000 {
		compatible = "rockchip,rk3528-vop";
		reg = <0x00 0xff840000 0x00 0x3000>,
		      <0x00 0xff845000 0x00 0x1000>,
		      <0x00 0xff846400 0x00 0x800>;
		reg-names = "regs", "gamma_lut", "acm_regs";
		interrupts = <GIC_SPI 109 IRQ_TYPE_LEVEL_HIGH>;
		clocks = <&cru ACLK_VOP>, <&cru HCLK_VOP>, <&cru DCLK_VOP0>, <&cru DCLK_VOP1>;
		clock-names = "aclk_vop", "hclk_vop", "dclk_vp0", "dclk_vp1";
		assigned-clocks = <&cru DCLK_VOP0>;
		assigned-clock-parents = <&inno_hdmiphy_clk>;
		iommus = <&vop_mmu>;
		rockchip,grf = <&grf>;
		status = "okay";
		esmart_lb_mode = [03];
		support-multi-area;
		phandle = <0xd9>;

		vop_out: ports {
			#address-cells = <1>;
			#size-cells = <0>;
			phandle = <0x12>;

			port@0 {
				#address-cells = <1>;
				#size-cells = <0>;
				reg = <0x00>;

				vp0_out_hdmi: endpoint@0 {
					reg = <0x00>;
					remote-endpoint = <&hdmi_in_vp0>;
					phandle = <0x15>;
				};
			};

			port@1 {
				#address-cells = <1>;
				#size-cells = <0>;
				reg = <0x01>;

				vp1_out_tve: endpoint@0 {
					reg = <0x00>;
					remote-endpoint = <&tve_in_vp1>;
					phandle = <0x16>;
				};
			};
		};
	};

	vop_mmu: iommu@ff847e00 {
		compatible = "rockchip,iommu-v2";
		reg = <0x00 0xff847e00 0x00 0x100>;
		interrupts = <GIC_SPI 109 IRQ_TYPE_LEVEL_HIGH>;
		interrupt-names = "vop_mmu";
		clocks = <&cru ACLK_VOP>, <&cru HCLK_VOP>;
		clock-names = "aclk", "iface";
		#iommu-cells = <0>;
		rockchip,disable-device-link-resume;
		rockchip,shootdown-entire;
		status = "okay";
		phandle = <0x32>;
	};

	rga2: rga@ff850000 {
		compatible = "rockchip,rga2_core0";
		reg = <0x00 0xff850000 0x00 0x1000>;
		interrupts = <GIC_SPI 105 IRQ_TYPE_LEVEL_HIGH>;
		interrupt-names = "rga2_irq";
		clocks = <&cru ACLK_RGA2E>, <&cru HCLK_RGA2E>, <&cru CLK_CORE_RGA2E>;
		clock-names = "aclk_rga2", "hclk_rga2", "clk_rga2";
		iommus = <&rga2_mmu>;
		rockchip,grf = <&grf>;
		rockchip,grf-offset = <0x600e0>;
		rockchip,grf-values = <0xff10000 0xff10ff1>;
		status = "okay";
		phandle = <0xda>;
	};

	rga2_mmu: iommu@ff850f00 {
		compatible = "rockchip,iommu-v2";
		reg = <0x00 0xff850f00 0x00 0x100>;
		interrupts = <GIC_SPI 105 IRQ_TYPE_LEVEL_HIGH>;
		interrupt-names = "rga2_mmu";
		clocks = <&cru ACLK_RGA2E>, <&cru HCLK_RGA2E>;
		clock-names = "aclk", "iface";
		#iommu-cells = <0>;
		status = "okay";
		phandle = <0x35>;
	};

	iep: iep@ff860000 {
		compatible = "rockchip,iep-v2";
		reg = <0x00 0xff860000 0x00 0x500>;
		interrupts = <GIC_SPI 106 IRQ_TYPE_LEVEL_HIGH>;
		clocks = <&cru ACLK_VDPP>, <&cru HCLK_VDPP>, <&cru CLK_CORE_VDPP>;
		clock-names = "aclk", "hclk", "sclk";
		rockchip,normal-rates = <340000000 0 340000000>;
		assigned-clocks = <&cru ACLK_VDPP>, <&cru CLK_CORE_VDPP>;
		assigned-clock-rates = <340000000>, <340000000>;
		resets = <&cru SRST_ARESETN_VDPP>,
		         <&cru SRST_HRESETN_VDPP>,
		         <&cru SRST_RESETN_CORE_VDPP>;
		reset-names = "shared_rst_a", "shared_rst_h", "shared_rst_s";
		rockchip,srv = <&mpp_srv>;
		rockchip,taskqueue-node = <3>;
		rockchip,resetgroup-node = <3>;
		iommus = <&iep_mmu>;
		status = "okay";
		phandle = <0xdb>;
	};

	iep_mmu: iommu@ff860800 {
		compatible = "rockchip,iommu-v2";
		reg = <0x00 0xff860800 0x00 0x100>;
		interrupts = <GIC_SPI 106 IRQ_TYPE_LEVEL_HIGH>;
		interrupt-names = "iep_mmu";
		clocks = <&cru ACLK_VDPP>, <&cru HCLK_VDPP>;
		clock-names = "aclk", "iface";
		#iommu-cells = <0>;
		rockchip,shootdown-entire;
		status = "okay";
		phandle = <0x36>;
	};

	vdpp: vdpp@ff861000 {
		compatible = "rockchip,vdpp-v1";
		reg = <0x00 0xff861000 0x00 0x100>, <0x00 0xff862000 0x00 0x900>;
		reg-names = "vdpp_regs", "zme_regs";
		interrupts = <GIC_SPI 106 IRQ_TYPE_LEVEL_HIGH>;
		clocks = <&cru ACLK_VDPP>, <&cru HCLK_VDPP>, <&cru CLK_CORE_VDPP>;
		clock-names = "aclk", "hclk", "sclk";
		rockchip,normal-rates = <340000000 0 340000000>;
		assigned-clocks = <&cru ACLK_VDPP>, <&cru CLK_CORE_VDPP>;
		assigned-clock-rates = <340000000>, <340000000>;
		resets = <&cru SRST_ARESETN_VDPP>,
		         <&cru SRST_HRESETN_VDPP>,
		         <&cru SRST_RESETN_CORE_VDPP>;
		reset-names = "shared_rst_a", "shared_rst_h", "shared_rst_s";
		rockchip,srv = <&mpp_srv>;
		rockchip,grf = <&grf>;
		rockchip,grf-mem-offset = <0x600e0>;
		rockchip,grf-mem-values = <0xf0040000 0xf004f004>;
		rockchip,taskqueue-node = <3>;
		rockchip,resetgroup-node = <3>;
		rockchip,disable-auto-freq;
		iommus = <&iep_mmu>;
		status = "okay";
		phandle = <0xdc>;
	};

	jpegd: jpegd@ff870000 {
		compatible = "rockchip,rkv-jpeg-decoder-v1";
		reg = <0x00 0xff870000 0x00 0x400>;
		interrupts = <GIC_SPI 107 IRQ_TYPE_LEVEL_HIGH>;
		clocks = <&cru ACLK_JPEG_DECODER>, <&cru HCLK_JPEG_DECODER>;
		clock-names = "aclk_vcodec", "hclk_vcodec";
		rockchip,normal-rates = <340000000 0>;
		assigned-clocks = <&cru ACLK_JPEG_DECODER>;
		assigned-clock-rates = <340000000>;
		rockchip,disable-auto-freq;
		resets = <&cru SRST_ARESETN_JPEG_DECODER>, <&cru SRST_HRESETN_JPEG_DECODER>;
		reset-names = "video_a", "video_h";
		iommus = <&jpegd_mmu>;
		rockchip,srv = <&mpp_srv>;
		rockchip,taskqueue-node = <4>;
		rockchip,resetgroup-node = <4>;
		status = "okay";
		phandle = <0xdd>;
	};

	jpegd_mmu: iommu@ff870480 {
		compatible = "rockchip,iommu-v2";
		reg = <0x00 0xff870480 0x00 0x40>;
		interrupts = <GIC_SPI 108 IRQ_TYPE_LEVEL_HIGH>;
		interrupt-names = "jpegd_mmu";
		clock-names = "aclk", "iface";
		clocks = <&cru ACLK_JPEG_DECODER>, <&cru HCLK_JPEG_DECODER>;
		#iommu-cells = <0>;
		rockchip,shootdown-entire;
		status = "okay";
		phandle = <0x37>;
	};

	tve: tve@ff880000 {
		compatible = "rockchip,rk3528-tve";
		reg = <0x00 0xff880000 0x00 0x4000 0x00 0xffde0000 0x00 0x300>;
		interrupts = <GIC_SPI 112 IRQ_TYPE_LEVEL_HIGH>;
		clocks = <&cru HCLK_CVBS>,
		         <&cru PCLK_VCDCPHY>,
		         <&cru DCLK_CVBS>,
		         <&cru DCLK_4X_CVBS>;
		clock-names = "hclk", "pclk_vdac", "dclk", "dclk_4x";
		rockchip,lumafilter0 = <0xff80006>;
		rockchip,lumafilter1 = <0x90010>;
		rockchip,lumafilter2 = <0xffb0fd8>;
		rockchip,lumafilter3 = <0x80057>;
		rockchip,lumafilter4 = <0xfef0f64>;
		rockchip,lumafilter5 = <0x16010a>;
		rockchip,lumafilter6 = <0xf830df7>;
		rockchip,lumafilter7 = <0x8de055f>;
		rockchip,tve-upsample = <0x02>;
		rockchip,grf = <&grf>;
		nvmem-cells = <&vdac_out_current>, <&test_version>;
		nvmem-cell-names = "out-current", "version";
		status = "okay";
		phandle = <0xde>;

		ports {
			#address-cells = <1>;
			#size-cells = <0>;

			port@0 {
				reg = <0x00>;
				#address-cells = <1>;
				#size-cells = <0>;

				tve_in_vp1: endpoint@0 {
					reg = <0x00>;
					remote-endpoint = <&vp1_out_tve>;
					status = "okay";
					phandle = <0x34>;
				};
			};
		};
	};

	hdcp2: hdcp2@ff8c0000 {
		compatible = "rockchip,rk3528-hdmi-hdcp2";
		reg = <0x00 0xff8c0000 0x00 0x2000>;
		interrupts = <GIC_SPI 104 IRQ_TYPE_LEVEL_HIGH>;
		clocks = <&cru ACLK_HDCP>, <&cru PCLK_HDCP>, <&cru HCLK_HDCP>;
		clock-names = "aclk_hdcp2", "pclk_hdcp2", "hdcp2_clk_hdmi";
		status = "disabled";
		phandle = <0xdf>;
	};

	hdmi: hdmi@ff8d0000 {
		compatible = "rockchip,rk3528-dw-hdmi";
		reg = <0x00 0xff8d0000 0x00 0x20000 0x00 0xff610000 0x00 0x200>;
		interrupts = <GIC_SPI 102 IRQ_TYPE_LEVEL_HIGH>, <GIC_SPI 103 IRQ_TYPE_LEVEL_HIGH>;
		interrupt-names = "hdmi", "hdmi_wakeup";
		clocks = <&cru PCLK_HDMI>,
		         <&cru CLK_SFR_HDMI>,
		         <&cru CLK_CEC_HDMI>,
		         <&inno_hdmiphy_clk>;
		clock-names = "iahb", "isfr", "cec", "dclk_vp0";
		ddc-i2c-scl-high-time-ns = <9625>;
		ddc-i2c-scl-low-time-ns = <10000>;
		reg-io-width = <4>;
		rockchip,grf = <&grf>;
		pinctrl-names = "default", "idle";
		pinctrl-0 = <&hdmi_pins>;
		pinctrl-1 = <&hdmi_pins_idle>;
		phys = <&hdmiphy>;
		phy-names = "hdmi";
		#sound-dai-cells = <0>;
		hpd-gpios = <&gpio0 2 GPIO_ACTIVE_HIGH>;
		status = "okay";
		phandle = <0x88>;

		ports {
			#address-cells = <1>;
			#size-cells = <0>;

			port@0 {
				reg = <0x00>;
				#address-cells = <1>;
				#size-cells = <0>;

				hdmi_in_vp0: endpoint@0 {
					reg = <0x00>;
					remote-endpoint = <&vp0_out_hdmi>;
					status = "okay";
					phandle = <0x33>;
				};
			};
		};
	};

	spi0: spi@ff9c0000 {
		compatible = "rockchip,rk3066-spi";
		reg = <0x00 0xff9c0000 0x00 0x1000>;
		interrupts = <GIC_SPI 131 IRQ_TYPE_LEVEL_HIGH>;
		#address-cells = <1>;
		#size-cells = <0>;
		clocks = <&cru CLK_SPI0>, <&cru PCLK_SPI0>, <&cru SCLK_IN_SPI0>;
		clock-names = "spiclk", "apb_pclk", "sclk_in";
		dmas = <&dmac 25>, <&dmac 24>;
		dma-names = "tx", "rx";
		pinctrl-names = "default";
		pinctrl-0 = <&spi0_csn0>, <&spi0_csn1>, <&spi0_pins>;
		status = "disabled";
		phandle = <0xe0>;
	};

	spi1: spi@ff9d0000 {
		compatible = "rockchip,rk3066-spi";
		reg = <0x00 0xff9d0000 0x00 0x1000>;
		interrupts = <GIC_SPI 132 IRQ_TYPE_LEVEL_HIGH>;
		#address-cells = <1>;
		#size-cells = <0>;
		clocks = <&cru CLK_SPI1>, <&cru PCLK_SPI1>, <&cru SCLK_IN_SPI1>;
		clock-names = "spiclk", "apb_pclk", "sclk_in";
		dmas = <&dmac 31>, <&dmac 30>;
		dma-names = "tx", "rx";
		pinctrl-names = "default";
		pinctrl-0 = <&spi1_csn0>, <&spi1_csn1>, <&spi1_pins>;
		status = "disabled";
		phandle = <0xe1>;
	};

	uart0: serial@ff9f0000 {
		compatible = "rockchip,rk3528-uart", "snps,dw-apb-uart";
		reg = <0x00 0xff9f0000 0x00 0x100>;
		interrupts = <GIC_SPI 40 IRQ_TYPE_LEVEL_HIGH>;
		clocks = <&cru SCLK_UART0>, <&cru PCLK_UART0>;
		clock-names = "baudclk", "apb_pclk";
		reg-shift = <2>;
		reg-io-width = <4>;
		dmas = <&dmac 9>, <&dmac 8>;
		status = "disabled";
		phandle = <0xe2>;
	};

	uart1: serial@ff9f8000 {
		compatible = "rockchip,rk3528-uart", "snps,dw-apb-uart";
		reg = <0x00 0xff9f8000 0x00 0x100>;
		interrupts = <GIC_SPI 41 IRQ_TYPE_LEVEL_HIGH>;
		clocks = <&cru SCLK_UART1>, <&cru PCLK_UART1>;
		clock-names = "baudclk", "apb_pclk";
		reg-shift = <2>;
		reg-io-width = <4>;
		dmas = <&dmac 11>, <&dmac 10>;
		status = "disabled";
		phandle = <0xe3>;
	};

	uart2: serial@ffa00000 {
		compatible = "rockchip,rk3528-uart", "snps,dw-apb-uart";
		reg = <0x00 0xffa00000 0x00 0x100>;
		interrupts = <GIC_SPI 42 IRQ_TYPE_LEVEL_HIGH>;
		clocks = <&cru SCLK_UART2>, <&cru PCLK_UART2>;
		clock-names = "baudclk", "apb_pclk";
		reg-shift = <2>;
		reg-io-width = <4>;
		dmas = <&dmac 13>, <&dmac 12>;
		status = "okay";
		pinctrl-names = "default";
		pinctrl-0 = <&uart2m1_xfer>, <&uart2m1_ctsn>;
		phandle = <0xe4>;
	};

	uart3: serial@ffa08000 {
		compatible = "rockchip,rk3528-uart", "snps,dw-apb-uart";
		reg = <0x00 0xffa08000 0x00 0x100>;
		interrupts = <GIC_SPI 43 IRQ_TYPE_LEVEL_HIGH>;
		clocks = <&cru SCLK_UART3>, <&cru PCLK_UART3>;
		clock-names = "baudclk", "apb_pclk";
		reg-shift = <2>;
		reg-io-width = <4>;
		dmas = <&dmac 15>, <&dmac 14>;
		status = "disabled";
		phandle = <0xe5>;
	};

	uart4: serial@ffa10000 {
		compatible = "rockchip,rk3528-uart", "snps,dw-apb-uart";
		reg = <0x00 0xffa10000 0x00 0x100>;
		interrupts = <GIC_SPI 44 IRQ_TYPE_LEVEL_HIGH>;
		clocks = <&cru SCLK_UART4>, <&cru PCLK_UART4>;
		clock-names = "baudclk", "apb_pclk";
		reg-shift = <2>;
		reg-io-width = <4>;
		dmas = <&dmac 17>, <&dmac 16>;
		status = "disabled";
		phandle = <0xe6>;
	};

	uart5: serial@ffa18000 {
		compatible = "rockchip,rk3528-uart", "snps,dw-apb-uart";
		reg = <0x00 0xffa18000 0x00 0x100>;
		interrupts = <GIC_SPI 45 IRQ_TYPE_LEVEL_HIGH>;
		clocks = <&cru SCLK_UART5>, <&cru PCLK_UART5>;
		clock-names = "baudclk", "apb_pclk";
		reg-shift = <2>;
		reg-io-width = <4>;
		dmas = <&dmac 19>, <&dmac 18>;
		status = "disabled";
		phandle = <0xe7>;
	};

	uart6: serial@ffa20000 {
		compatible = "rockchip,rk3528-uart", "snps,dw-apb-uart";
		reg = <0x00 0xffa20000 0x00 0x100>;
		interrupts = <GIC_SPI 46 IRQ_TYPE_LEVEL_HIGH>;
		clocks = <&cru SCLK_UART6>, <&cru PCLK_UART6>;
		clock-names = "baudclk", "apb_pclk";
		reg-shift = <2>;
		reg-io-width = <4>;
		dmas = <&dmac 21>, <&dmac 20>;
		status = "disabled";
		phandle = <0xe8>;
	};

	uart7: serial@ffa28000 {
		compatible = "rockchip,rk3528-uart", "snps,dw-apb-uart";
		reg = <0x00 0xffa28000 0x00 0x100>;
		interrupts = <GIC_SPI 47 IRQ_TYPE_LEVEL_HIGH>;
		clocks = <&cru SCLK_UART7>, <&cru PCLK_UART7>;
		clock-names = "baudclk", "apb_pclk";
		reg-shift = <2>;
		reg-io-width = <4>;
		dmas = <&dmac 23>, <&dmac 22>;
		status = "disabled";
		phandle = <0xe9>;
	};

	i2c0: i2c@ffa50000 {
		compatible = "rockchip,rk3528-i2c", "rockchip,rk3399-i2c";
		reg = <0x00 0xffa50000 0x00 0x1000>;
		clocks = <&cru CLK_I2C0>, <&cru PCLK_I2C0>;
		clock-names = "i2c", "pclk";
		interrupts = <GIC_SPI 61 IRQ_TYPE_LEVEL_HIGH>;
		pinctrl-names = "default";
		pinctrl-0 = <&i2c0m0_xfer>;
		#address-cells = <1>;
		#size-cells = <0>;
		status = "disabled";
		phandle = <0xea>;
	};

	i2c1: i2c@ffa58000 {
		compatible = "rockchip,rk3528-i2c", "rockchip,rk3399-i2c";
		reg = <0x00 0xffa58000 0x00 0x1000>;
		clocks = <&cru CLK_I2C1>, <&cru PCLK_I2C1>;
		clock-names = "i2c", "pclk";
		interrupts = <GIC_SPI 62 IRQ_TYPE_LEVEL_HIGH>;
		pinctrl-names = "default";
		pinctrl-0 = <&i2c1m0_xfer>;
		#address-cells = <1>;
		#size-cells = <0>;
		status = "disabled";
		phandle = <0xeb>;
	};

	i2c2: i2c@ffa60000 {
		compatible = "rockchip,rk3528-i2c", "rockchip,rk3399-i2c";
		reg = <0x00 0xffa60000 0x00 0x1000>;
		clocks = <&cru CLK_I2C2>, <&cru PCLK_I2C2>;
		clock-names = "i2c", "pclk";
		interrupts = <GIC_SPI 63 IRQ_TYPE_LEVEL_HIGH>;
		pinctrl-names = "default";
		pinctrl-0 = <&i2c2m0_xfer>;
		#address-cells = <1>;
		#size-cells = <0>;
		status = "disabled";
		phandle = <0xec>;
	};

	i2c3: i2c@ffa68000 {
		compatible = "rockchip,rk3528-i2c", "rockchip,rk3399-i2c";
		reg = <0x00 0xffa68000 0x00 0x1000>;
		clocks = <&cru CLK_I2C3>, <&cru PCLK_I2C3>;
		clock-names = "i2c", "pclk";
		interrupts = <GIC_SPI 64 IRQ_TYPE_LEVEL_HIGH>;
		pinctrl-names = "default";
		pinctrl-0 = <&i2c3m0_xfer>;
		#address-cells = <1>;
		#size-cells = <0>;
		status = "disabled";
		phandle = <0xed>;
	};

	i2c4: i2c@ffa70000 {
		compatible = "rockchip,rk3528-i2c", "rockchip,rk3399-i2c";
		reg = <0x00 0xffa70000 0x00 0x1000>;
		clocks = <&cru CLK_I2C4>, <&cru PCLK_I2C4>;
		clock-names = "i2c", "pclk";
		interrupts = <GIC_SPI 65 IRQ_TYPE_LEVEL_HIGH>;
		pinctrl-names = "default";
		pinctrl-0 = <&i2c4_xfer>;
		#address-cells = <1>;
		#size-cells = <0>;
		status = "disabled";
		phandle = <0xee>;
	};

	i2c5: i2c@ffa78000 {
		compatible = "rockchip,rk3528-i2c", "rockchip,rk3399-i2c";
		reg = <0x00 0xffa78000 0x00 0x1000>;
		clocks = <&cru CLK_I2C5>, <&cru PCLK_I2C5>;
		clock-names = "i2c", "pclk";
		interrupts = <GIC_SPI 66 IRQ_TYPE_LEVEL_HIGH>;
		pinctrl-names = "default";
		pinctrl-0 = <&i2c5m0_xfer>;
		#address-cells = <1>;
		#size-cells = <0>;
		status = "disabled";
		phandle = <0xef>;
	};

	i2c6: i2c@ffa80000 {
		compatible = "rockchip,rk3528-i2c", "rockchip,rk3399-i2c";
		reg = <0x00 0xffa80000 0x00 0x1000>;
		clocks = <&cru CLK_I2C6>, <&cru PCLK_I2C6>;
		clock-names = "i2c", "pclk";
		interrupts = <GIC_SPI 67 IRQ_TYPE_LEVEL_HIGH>;
		pinctrl-names = "default";
		pinctrl-0 = <&i2c6m0_xfer>;
		#address-cells = <1>;
		#size-cells = <0>;
		status = "disabled";
		phandle = <0xf0>;

		es7243e: es7243e@10 {
			status = "okay";
			#sound-dai-cells = <0>;
			compatible = "ES7243E_MicArray_0";
			reg = <0x10>;
			phandle = <0xf1>;
		};

		es7243e_11: es7243e@11 {
			status = "okay";
			#sound-dai-cells = <0>;
			compatible = "ES7243E_MicArray_1";
			reg = <0x11>;
			phandle = <0xf2>;
		};

		es7243e_12: es7243e@12 {
			status = "okay";
			#sound-dai-cells = <0>;
			compatible = "ES7243E_MicArray_2";
			reg = <0x12>;
			phandle = <0xf3>;
		};
	};

	i2c7: i2c@ffa88000 {
		compatible = "rockchip,rk3528-i2c", "rockchip,rk3399-i2c";
		reg = <0x00 0xffa88000 0x00 0x1000>;
		clocks = <&cru CLK_I2C7>, <&cru PCLK_I2C7>;
		clock-names = "i2c", "pclk";
		interrupts = <GIC_SPI 68 IRQ_TYPE_LEVEL_HIGH>;
		pinctrl-names = "default";
		pinctrl-0 = <&i2c7_xfer>;
		#address-cells = <1>;
		#size-cells = <0>;
		status = "disabled";
		phandle = <0xf4>;
	};

	pwm0: pwm@ffa90000 {
		compatible = "rockchip,rk3528-pwm", "rockchip,rk3328-pwm";
		reg = <0x00 0xffa90000 0x00 0x10>;
		#pwm-cells = <3>;
		pinctrl-names = "active";
		pinctrl-0 = <&pwm0m0_pins>;
		clocks = <&cru CLK_PWM0>, <&cru PCLK_PWM0>;
		clock-names = "pwm", "pclk";
		status = "disabled";
		phandle = <0xf5>;
	};

	pwm1: pwm@ffa90010 {
		compatible = "rockchip,rk3528-pwm", "rockchip,rk3328-pwm";
		reg = <0x00 0xffa90010 0x00 0x10>;
		#pwm-cells = <3>;
		pinctrl-names = "active";
		pinctrl-0 = <&pwm1m0_pins>;
		clocks = <&cru CLK_PWM0>, <&cru PCLK_PWM0>;
		clock-names = "pwm", "pclk";
		status = "disabled";
		phandle = <0xf6>;
	};

	pwm2: pwm@ffa90020 {
		compatible = "rockchip,rk3528-pwm", "rockchip,rk3328-pwm";
		reg = <0x00 0xffa90020 0x00 0x10>;
		#pwm-cells = <3>;
		pinctrl-names = "active";
		pinctrl-0 = <&pwm2m0_pins>;
		clocks = <&cru CLK_PWM0>, <&cru PCLK_PWM0>;
		clock-names = "pwm", "pclk";
		status = "okay";
		phandle = <0x91>;
	};

	pwm3: pwm@ffa90030 {
		compatible = "rockchip,remotectl-pwm";
		reg = <0x00 0xffa90030 0x00 0x10>;
		interrupts = <GIC_SPI 53 IRQ_TYPE_LEVEL_HIGH>, <GIC_SPI 54 IRQ_TYPE_LEVEL_HIGH>;
		#pwm-cells = <3>;
		pinctrl-names = "default";
		pinctrl-0 = <&pwm3m0_pins>;
		clocks = <&cru CLK_PWM0>, <&cru PCLK_PWM0>;
		clock-names = "pwm", "pclk";
		status = "okay";
		remote_pwm_id = <0x03>;
		handle_cpu_id = <0x01>;
		remote_support_psci = <0x00>;
		phandle = <0xf7>;

		ir_key1 {
			rockchip,usercode = <0x4040>;
			rockchip,key_table = <0xf2 0xe8 0xba 0x9e 0xf4 0x67 0xf1 0x6c 0xef 0x69 0xee 0x6a 0xbd 0x66 0xea 0x73 0xe3 0x72 0xe2 0xd9 0xb2 0x74 0xbc 0x71 0xec 0x8b 0xbf 0x190 0xe0 0x191 0xe1 0x192 0xe9 0xb7 0xe6 0xf8 0xe8 0xb9 0xe7 0xba 0xf0 0x184 0xbe 0x175>;
		};

		ir_key2 {
			rockchip,usercode = <0xff00>;
			rockchip,key_table = <0xf9 0x66 0xbf 0x9e 0xfb 0x8b 0xaa 0xe8 0xb9 0x67 0xe9 0x6c 0xb8 0x69 0xea 0x6a 0xeb 0x72 0xef 0x73 0xf7 0x71 0xe7 0x74 0xfc 0x74 0xa9 0x72 0xa8 0xa4 0xe0 0x72 0xa5 0x72 0xab 0xb7 0xb7 0x184 0xe8 0x184 0xf8 0xb8 0xaf 0xb9 0xed 0x72 0xee 0xba 0xb3 0x72 0xf1 0x72 0xf2 0x72 0xf3 0xd9 0xb4 0x72 0xa4 0x8d 0xbe 0xd9>;
		};

		ir_key3 {
			rockchip,usercode = <0x1dcc>;
			rockchip,key_table = <0xee 0xe8 0xf0 0x9e 0xf8 0x67 0xbb 0x6c 0xef 0x69 0xed 0x6a 0xfc 0x66 0xf1 0x73 0xfd 0x72 0xb7 0xd9 0xff 0x74 0xf3 0x71 0xbf 0x8b 0xf9 0x191 0xf5 0x192 0xb3 0x184 0xbe 0x02 0xba 0x03 0xb2 0x04 0xbd 0x05 0xf9 0x06 0xb1 0x07 0xfc 0x08 0xf8 0x09 0xb0 0x0a 0xb6 0x0b 0xb5 0x0e>;
		};

		ir_key4 {
			rockchip,usercode = <0x7f80>;
			rockchip,key_table = <0xec 0xe8 0xd8 0x9e 0xc7 0x67 0xbf 0x6c 0xc8 0x69 0xc6 0x6a 0x8c 0x66 0x78 0x73 0x76 0x72 0x7e 0x74 0x7c 0x8b 0xb7 0x184>;
		};

		ir_key5 {
			rockchip,usercode = <0xfe01>;
			rockchip,key_table = <0xec 0xe8 0xe6 0x9e 0xe9 0x67 0xe5 0x6c 0xae 0x69 0xaf 0x6a 0xee 0x66 0xe7 0x73 0xef 0x72 0xbf 0x74 0xbe 0x71 0xb3 0x8b 0xff 0x184 0xb1 0x02 0xf2 0x03 0xf3 0x04 0xb5 0x05 0xf6 0x06 0xf7 0x07 0xb9 0x08 0xfa 0x09 0xfb 0x0a 0xfe 0x0b 0xbd 0x0e 0xbc 0xb7 0xf0 0xba 0xb4 0x19c 0xb8 0x1e 0xb0 0x197>;
		};

		ir_key6 {
			rockchip,usercode = <0xfd01>;
			rockchip,key_table = <0x31 0xe8 0x2f 0x9e 0x35 0x67 0x2d 0x6c 0x66 0x69 0x3e 0x6a 0x6a 0x66 0x5e 0x73 0x47 0x72 0x23 0x74 0x3a 0x184 0x0d 0x40>;
		};
	};

	pwm4: pwm@ffa98000 {
		compatible = "rockchip,rk3528-pwm", "rockchip,rk3328-pwm";
		reg = <0x00 0xffa98000 0x00 0x10>;
		#pwm-cells = <3>;
		pinctrl-names = "active";
		pinctrl-0 = <&pwm4m0_pins>;
		clocks = <&cru CLK_PWM1>, <&cru PCLK_PWM1>;
		clock-names = "pwm", "pclk";
		status = "okay";
		phandle = <0x93>;
	};

	pwm5: pwm@ffa98010 {
		compatible = "rockchip,rk3528-pwm", "rockchip,rk3328-pwm";
		reg = <0x00 0xffa98010 0x00 0x10>;
		#pwm-cells = <3>;
		pinctrl-names = "active";
		pinctrl-0 = <&pwm5m0_pins>;
		clocks = <&cru CLK_PWM0>, <&cru PCLK_PWM0>;
		clock-names = "pwm", "pclk";
		status = "disabled";
		phandle = <0xf8>;
	};

	pwm6: pwm@ffa98020 {
		compatible = "rockchip,rk3528-pwm", "rockchip,rk3328-pwm";
		reg = <0x00 0xffa98020 0x00 0x10>;
		#pwm-cells = <3>;
		pinctrl-names = "active";
		pinctrl-0 = <&pwm6m0_pins>;
		clocks = <&cru CLK_PWM0>, <&cru PCLK_PWM0>;
		clock-names = "pwm", "pclk";
		status = "disabled";
		phandle = <0xf9>;
	};

	pwm7: pwm@ffa98030 {
		compatible = "rockchip,rk3528-pwm", "rockchip,rk3328-pwm";
		reg = <0x00 0xffa98030 0x00 0x10>;
		interrupts = <GIC_SPI 55 IRQ_TYPE_LEVEL_HIGH>, <GIC_SPI 56 IRQ_TYPE_LEVEL_HIGH>;
		#pwm-cells = <3>;
		pinctrl-names = "active";
		pinctrl-0 = <&pwm7m0_pins>;
		clocks = <&cru CLK_PWM0>, <&cru PCLK_PWM0>;
		clock-names = "pwm", "pclk";
		status = "okay";
		phandle = <0x92>;
	};

	rktimer: timer@ffab0000 {
		compatible = "rockchip,rk3528-timer", "rockchip,rk3288-timer";
		reg = <0x00 0xffab0000 0x00 0x20>;
		interrupts = <GIC_SPI 31 IRQ_TYPE_LEVEL_HIGH>;
		clocks = <&cru PCLK_TIMER>, <&cru CLK_TIMER0>;
		clock-names = "pclk", "timer";
		phandle = <0xfa>;
	};

	wdt: watchdog@ffac0000 {
		compatible = "snps,dw-wdt";
		reg = <0x00 0xffac0000 0x00 0x100>;
		clocks = <&cru TCLK_WDT_NS>, <&cru PCLK_WDT_NS>;
		clock-names = "tclk", "pclk";
		interrupts = <GIC_SPI 28 IRQ_TYPE_LEVEL_HIGH>;
		status = "disabled";
		phandle = <0xfb>;
	};

	tsadc: tsadc@ffad0000 {
		compatible = "rockchip,rk3528-tsadc";
		reg = <0x00 0xffad0000 0x00 0x400>;
		rockchip,grf = <&grf>;
		interrupts = <GIC_SPI 139 IRQ_TYPE_LEVEL_HIGH>;
		clocks = <&cru CLK_TSADC>, <&cru CLK_TSADC_TSEN>, <&cru PCLK_TSADC>;
		clock-names = "tsadc", "tsadc_tsen", "apb_pclk";
		assigned-clocks = <&cru CLK_TSADC>, <&cru CLK_TSADC_TSEN>;
		assigned-clock-rates = <1200000>, <12000000>;
		resets = <&cru SRST_RESETN_TSADC>, <&cru SRST_PRESETN_TSADC>;
		reset-names = "tsadc", "tsadc-apb";
		#thermal-sensor-cells = <1>;
		rockchip,hw-tshut-temp = <120000>;
		rockchip,hw-tshut-mode = <0x00>;
		rockchip,hw-tshut-polarity = <0x00>;
		status = "okay";
		phandle = <0x1c>;
	};

	saradc: saradc@ffae0000 {
		compatible = "rockchip,rk3528-saradc";
		reg = <0x00 0xffae0000 0x00 0x10000>;
		interrupts = <GIC_SPI 140 IRQ_TYPE_LEVEL_HIGH>;
		#io-channel-cells = <1>;
		clocks = <&cru CLK_SARADC>, <&cru PCLK_SARADC>;
		clock-names = "saradc", "apb_pclk";
		resets = <&cru SRST_PRESETN_SARADC>;
		reset-names = "saradc-apb";
		status = "okay";
		vref-supply = <&vdd_1v8_s3>;
		phandle = <0x85>;
	};

	sai3: sai@ffb70000 {
		compatible = "rockchip,rk3528-sai", "rockchip,sai-v1";
		reg = <0x00 0xffb70000 0x00 0x1000>;
		interrupts = <GIC_SPI 128 IRQ_TYPE_LEVEL_HIGH>;
		clocks = <&cru MCLK_SAI_I2S3>, <&cru HCLK_SAI_I2S3>;
		clock-names = "mclk", "hclk";
		dmas = <&dmac 5>;
		dma-names = "tx";
		resets = <&cru SRST_MRESETN_SAI_I2S3>, <&cru SRST_HRESETN_SAI_I2S3>;
		reset-names = "m", "h";
		#sound-dai-cells = <0>;
		status = "okay";
		phandle = <0x87>;
	};

	sai0: sai@ffb80000 {
		compatible = "rockchip,rk3528-sai", "rockchip,sai-v1";
		reg = <0x00 0xffb80000 0x00 0x1000>;
		interrupts = <GIC_SPI 125 IRQ_TYPE_LEVEL_HIGH>;
		clocks = <&cru MCLK_SAI_I2S0>, <&cru HCLK_SAI_I2S0>;
		clock-names = "mclk", "hclk";
		dmas = <&dmac 1>, <&dmac 0>;
		dma-names = "tx", "rx";
		resets = <&cru SRST_MRESETN_SAI_I2S0>, <&cru SRST_HRESETN_SAI_I2S0>;
		reset-names = "m", "h";
		pinctrl-names = "default";
		pinctrl-0 = <&i2s0m0_pins>;
		#sound-dai-cells = <0>;
		status = "disabled";
		phandle = <0xfc>;
	};

	sai2: sai@ffb90000 {
		compatible = "rockchip,rk3528-sai", "rockchip,sai-v1";
		reg = <0x00 0xffb90000 0x00 0x1000>;
		interrupts = <GIC_SPI 127 IRQ_TYPE_LEVEL_HIGH>;
		clocks = <&cru MCLK_SAI_I2S2>, <&cru HCLK_SAI_I2S2>;
		clock-names = "mclk", "hclk";
		dmas = <&dmac 4>;
		dma-names = "tx";
		resets = <&cru SRST_MRESETN_SAI_I2S2>, <&cru SRST_HRESETN_SAI_I2S2>;
		reset-names = "m", "h";
		#sound-dai-cells = <0>;
		status = "okay";
		phandle = <0x82>;
	};

	sai1: sai@ffba0000 {
		compatible = "rockchip,rk3528-sai", "rockchip,sai-v1";
		reg = <0x00 0xffba0000 0x00 0x1000>;
		interrupts = <GIC_SPI 126 IRQ_TYPE_LEVEL_HIGH>;
		clocks = <&cru MCLK_SAI_I2S1>, <&cru HCLK_SAI_I2S1>;
		clock-names = "mclk", "hclk";
		dmas = <&dmac 3>, <&dmac 2>;
		dma-names = "tx", "rx";
		resets = <&cru SRST_MRESETN_SAI_I2S1>, <&cru SRST_HRESETN_SAI_I2S1>;
		reset-names = "m", "h";
		pinctrl-names = "default";
		pinctrl-0 = <&i2s1_pins>;
		#sound-dai-cells = <0>;
		status = "disabled";
		phandle = <0xfd>;
	};

	pdm: pdm@ffbb0000 {
		compatible = "rockchip,rk3528-pdm", "rockchip,rk3568-pdm";
		reg = <0x00 0xffbb0000 0x00 0x1000>;
		clocks = <&cru MCLK_PDM>, <&cru HCLK_PDM>;
		clock-names = "pdm_clk", "pdm_hclk";
		dmas = <&dmac 6>;
		dma-names = "rx";
		pinctrl-names = "default";
		pinctrl-0 = <&pdm_clk0>,
		            <&pdm_clk1>,
		            <&pdm_sdi0>,
		            <&pdm_sdi1>,
		            <&pdm_sdi2>,
		            <&pdm_sdi3>;
		#sound-dai-cells = <0>;
		status = "disabled";
		phandle = <0x89>;
	};

	spdif_8ch: spdif@ffbc0000 {
		compatible = "rockchip,rk3528-spdif", "rockchip,rk3568-spdif";
		reg = <0x00 0xffbc0000 0x00 0x1000>;
		interrupts = <GIC_SPI 130 IRQ_TYPE_LEVEL_HIGH>;
		dmas = <&dmac 7>;
		dma-names = "tx";
		clock-names = "mclk", "hclk";
		clocks = <&cru MCLK_SPDIF>, <&cru HCLK_SPDIF>;
		#sound-dai-cells = <0>;
		pinctrl-names = "default";
		pinctrl-0 = <&spdifm0_pins>;
		status = "okay";
		phandle = <0x8b>;
	};

	gmac0: ethernet@ffbd0000 {
		compatible = "rockchip,rk3528-gmac", "snps,dwmac-4.20a";
		reg = <0x00 0xffbd0000 0x00 0x10000>;
		interrupts = <GIC_SPI 113 IRQ_TYPE_LEVEL_HIGH>, <GIC_SPI 116 IRQ_TYPE_LEVEL_HIGH>;
		interrupt-names = "macirq", "eth_wake_irq";
		rockchip,grf = <&grf>;
		clocks = <&cru CLK_GMAC0_SRC>,
		         <&cru CLK_GMAC0_RMII_50M>,
		         <&cru CLK_GMAC0_RX>,
		         <&cru CLK_GMAC0_TX>,
		         <&cru PCLK_MAC_VO>,
		         <&cru ACLK_MAC_VO>;
		clock-names = "stmmaceth", "clk_mac_ref", "mac_clk_rx", "mac_clk_tx", "pclk_mac", "aclk_mac";
		resets = <&cru SRST_ARESETN_MAC_VO>;
		reset-names = "stmmaceth";
		snps,mixed-burst;
		snps,tso;
		snps,axi-config = <&gmac0_stmmac_axi_setup>;
		snps,mtl-rx-config = <&gmac0_mtl_rx_setup>;
		snps,mtl-tx-config = <&gmac0_mtl_tx_setup>;
		phy-mode = "rmii";
		clock_in_out = "input";
		phy-handle = <&rmii0_phy>;
		nvmem-cells = <&macphy_bgs>;
		nvmem-cell-names = "bgs";
		status = "okay";
		phandle = <0xfe>;

		mdio0: mdio {
			compatible = "snps,dwmac-mdio";
			#address-cells = <1>;
			#size-cells = <0>;
			phandle = <0xff>;

			rmii0_phy: ethernet-phy@2 {
				compatible = "ethernet-phy-id0044.1400", "ethernet-phy-ieee802.3-c22";
				reg = <0x02>;
				clocks = <&cru CLK_MACPHY>;
				resets = <&cru SRST_RESETN_MACPHY>;
				phy-is-integrated;
				pinctrl-names = "default";
				nvmem-cells = <&macphy_txlevel>;
				nvmem-cell-names = "txlevel";
				phandle = <0x64>;
			};
		};

		gmac0_stmmac_axi_setup: stmmac-axi-config {
			snps,wr_osr_lmt = <4>;
			snps,rd_osr_lmt = <8>;
			snps,blen = <0 0 0 0 16 8 4>;
			phandle = <0x61>;
		};

		gmac0_mtl_rx_setup: rx-queues-config {
			snps,rx-queues-to-use = <1>;
			phandle = <0x62>;

			queue0 {
			};
		};

		gmac0_mtl_tx_setup: tx-queues-config {
			snps,tx-queues-to-use = <1>;
			phandle = <0x63>;

			queue0 {
			};
		};
	};

	gmac1: ethernet@ffbe0000 {
		compatible = "rockchip,rk3528-gmac", "snps,dwmac-4.20a";
		reg = <0x00 0xffbe0000 0x00 0x10000>;
		interrupts = <GIC_SPI 121 IRQ_TYPE_LEVEL_HIGH>, <GIC_SPI 124 IRQ_TYPE_LEVEL_HIGH>;
		interrupt-names = "macirq", "eth_wake_irq";
		rockchip,grf = <&grf>;
		clocks = <&cru CLK_GMAC1_SRC_VPU>,
		         <&cru CLK_GMAC1_RMII_VPU>,
		         <&cru PCLK_MAC_VPU>,
		         <&cru ACLK_MAC_VPU>;
		clock-names = "stmmaceth", "clk_mac_ref", "pclk_mac", "aclk_mac";
		resets = <&cru SRST_ARESETN_MAC>;
		reset-names = "stmmaceth";
		snps,mixed-burst;
		snps,tso;
		snps,axi-config = <&gmac1_stmmac_axi_setup>;
		snps,mtl-rx-config = <&gmac1_mtl_rx_setup>;
		snps,mtl-tx-config = <&gmac1_mtl_tx_setup>;
		status = "disabled";
		phandle = <0x100>;

		mdio1: mdio {
			compatible = "snps,dwmac-mdio";
			#address-cells = <1>;
			#size-cells = <0>;
			phandle = <0x101>;
		};

		gmac1_stmmac_axi_setup: stmmac-axi-config {
			snps,wr_osr_lmt = <4>;
			snps,rd_osr_lmt = <8>;
			snps,blen = <0 0 0 0 16 8 4>;
			phandle = <0x67>;
		};

		gmac1_mtl_rx_setup: rx-queues-config {
			snps,rx-queues-to-use = <1>;
			phandle = <0x68>;

			queue0 {
			};
		};

		gmac1_mtl_tx_setup: tx-queues-config {
			snps,tx-queues-to-use = <1>;
			phandle = <0x69>;

			queue0 {
			};
		};
	};

	sdhci: mmc@ffbf0000 {
		compatible = "rockchip,rk3528-dwcmshc";
		reg = <0x00 0xffbf0000 0x00 0x10000>;
		interrupts = <GIC_SPI 136 IRQ_TYPE_LEVEL_HIGH>;
		assigned-clocks = <&cru BCLK_EMMC>, <&cru TCLK_EMMC>, <&cru CCLK_SRC_EMMC>;
		assigned-clock-rates = <200000000>, <24000000>, <200000000>;
		clocks = <&cru CCLK_SRC_EMMC>,
		         <&cru HCLK_EMMC>,
		         <&cru ACLK_EMMC>,
		         <&cru BCLK_EMMC>,
		         <&cru TCLK_EMMC>;
		clock-names = "core", "bus", "axi", "block", "timer";
		resets = <&cru SRST_CRESETN_EMMC>,
		         <&cru SRST_HRESETN_EMMC>,
		         <&cru SRST_ARESETN_EMMC>,
		         <&cru SRST_BRESETN_EMMC>,
		         <&cru SRST_TRESETN_EMMC>;
		reset-names = "core", "bus", "axi", "block", "timer";
		max-frequency = <200000000>;
		status = "okay";
		bus-width = <8>;
		no-sd;
		no-sdio;
		non-removable;
		mmc-hs400-1_8v;
		mmc-hs400-enhanced-strobe;
		phandle = <0x102>;
	};

	sfc: spi@ffc00000 {
		compatible = "rockchip,sfc";
		reg = <0x00 0xffc00000 0x00 0x4000>;
		interrupts = <GIC_SPI 135 IRQ_TYPE_LEVEL_HIGH>;
		clocks = <&cru SCLK_SFC>, <&cru HCLK_SFC>;
		clock-names = "clk_sfc", "hclk_sfc";
		assigned-clocks = <&cru SCLK_SFC>;
		assigned-clock-rates = <100000000>;
		#address-cells = <1>;
		#size-cells = <0>;
		status = "okay";
		phandle = <0x103>;
	};

	sdio0: mmc@ffc10000 {
		compatible = "rockchip,rk3528-dw-mshc", "rockchip,rk3288-dw-mshc";
		reg = <0x00 0xffc10000 0x00 0x4000>;
		interrupts = <GIC_SPI 137 IRQ_TYPE_LEVEL_HIGH>;
		max-frequency = <200000000>;
		clocks = <&cru HCLK_SDIO0>, <&cru CCLK_SRC_SDIO0>, <&grf_cru 3>, <&grf_cru 4>;
		clock-names = "biu", "ciu", "ciu-drive", "ciu-sample";
		fifo-depth = <256>;
		resets = <&cru SRST_HRESETN_SDIO0>;
		reset-names = "reset";
		rockchip,use-v2-tuning;
		status = "okay";
		no-sd;
		no-mmc;
		supports-sdio;
		bus-width = <4>;
		disable-wp;
		cap-sd-highspeed;
		cap-sdio-irq;
		keep-power-in-suspend;
		non-removable;
		mmc-pwrseq = <&sdio_pwrseq>;
		pinctrl-names = "default";
		pinctrl-0 = <&sdio0_bus4>, <&sdio0_cmd>, <&sdio0_clk>;
		sd-uhs-sdr104;
		phandle = <0x104>;
	};

	sdio1: mmc@ffc20000 {
		compatible = "rockchip,rk3528-dw-mshc", "rockchip,rk3288-dw-mshc";
		reg = <0x00 0xffc20000 0x00 0x4000>;
		interrupts = <GIC_SPI 138 IRQ_TYPE_LEVEL_HIGH>;
		max-frequency = <150000000>;
		clocks = <&cru HCLK_SDIO1>, <&cru CCLK_SRC_SDIO1>, <&grf_cru 5>, <&grf_cru 6>;
		clock-names = "biu", "ciu", "ciu-drive", "ciu-sample";
		fifo-depth = <256>;
		resets = <&cru SRST_HRESETN_SDIO1>;
		reset-names = "reset";
		rockchip,use-v2-tuning;
		status = "disabled";
		phandle = <0x105>;
	};

	sdmmc: mmc@ffc30000 {
		compatible = "rockchip,rk3528-dw-mshc", "rockchip,rk3288-dw-mshc";
		reg = <0x00 0xffc30000 0x00 0x4000>;
		interrupts = <GIC_SPI 133 IRQ_TYPE_LEVEL_HIGH>;
		max-frequency = <150000000>;
		clocks = <&cru HCLK_SDMMC0>, <&cru CCLK_SRC_SDMMC0>, <&grf_cru 1>, <&grf_cru 2>;
		clock-names = "biu", "ciu", "ciu-drive", "ciu-sample";
		fifo-depth = <256>;
		resets = <&cru SRST_HRESETN_SDMMC0>;
		reset-names = "reset";
		rockchip,use-v2-tuning;
		status = "okay";
		bus-width = <4>;
		cap-mmc-highspeed;
		cap-sd-highspeed;
		disable-wp;
		pinctrl-names = "default";
		pinctrl-0 = <&sdmmc_clk>, <&sdmmc_cmd>, <&sdmmc_det>, <&sdmmc_bus4>;
		rockchip,default-sample-phase = <90>;
		supports-sd;
		sd-uhs-sdr12;
		sd-uhs-sdr25;
		sd-uhs-sdr50;
		sd-uhs-sdr104;
		vqmmc-supply = <&vccio_sd>;
		vmmc-supply = <&vcc_sd>;
		phandle = <0x106>;
	};

	crypto: crypto@ffc40000 {
		compatible = "rockchip,crypto-v4";
		reg = <0x00 0xffc40000 0x00 0x2000>;
		interrupts = <GIC_SPI 19 IRQ_TYPE_LEVEL_HIGH>;
		clocks = <&scmi_clk SCMI_ACLK_CRYPTO>,
		         <&scmi_clk SCMI_HCLK_CRYPTO>,
		         <&scmi_clk SCMI_CORE_CRYPTO>,
		         <&scmi_clk SCMI_PKA_CRYPTO>;
		clock-names = "aclk", "hclk", "sclk", "pka";
		assigned-clocks = <&scmi_clk SCMI_CORE_CRYPTO>, <&scmi_clk SCMI_PKA_CRYPTO>;
		assigned-clock-rates = <300000000>, <300000000>;
		resets = <&cru SRST_RESETN_CORE_CRYPTO>;
		reset-names = "crypto-rst";
		status = "okay";
		phandle = <0x107>;
	};

	rng: rng@ffc50000 {
		compatible = "rockchip,rkrng";
		reg = <0x00 0xffc50000 0x00 0x200>;
		interrupts = <GIC_SPI 23 IRQ_TYPE_LEVEL_HIGH>;
		clocks = <&scmi_clk SCMI_HCLK_TRNG>;
		clock-names = "hclk_trng";
		resets = <&cru SRST_HRESETN_TRNG_NS>;
		reset-names = "reset";
		status = "okay";
		phandle = <0x108>;
	};

	otp: otp@ffce0000 {
		compatible = "rockchip,rk3528-otp";
		reg = <0x00 0xffce0000 0x00 0x4000>;
		#address-cells = <1>;
		#size-cells = <1>;
		clocks = <&cru CLK_USER_OTPC_NS>, <&cru CLK_SBPI_OTPC_NS>, <&cru PCLK_OTPC_NS>;
		clock-names = "usr", "sbpi", "apb";
		resets = <&cru SRST_RESETN_USER_OTPC_NS>,
		         <&cru SRST_RESETN_SBPI_OTPC_NS>,
		         <&cru SRST_PRESETN_OTPC_NS>;
		reset-names = "usr", "sbpi", "apb";
		phandle = <0x109>;

		cpu_code: cpu-code@2 {
			reg = <0x02 0x02>;
			phandle = <0x11>;
		};

		otp_cpu_version: cpu-version@8 {
			reg = <0x08 0x01>;
			bits = <3 3>;
			phandle = <0x10>;
		};

		otp_id: id@a {
			reg = <0x0a 0x10>;
			phandle = <0x0f>;
		};

		cpu_leakage: cpu-leakage@1a {
			reg = <0x1a 0x01>;
			phandle = <0x0c>;
		};

		log_leakage: log-leakage@1b {
			reg = <0x1b 0x01>;
			phandle = <0x19>;
		};

		gpu_leakage: gpu-leakage@1c {
			reg = <0x1c 0x01>;
			phandle = <0x29>;
		};

		test_version: test-version@29 {
			reg = <0x29 0x01>;
			phandle = <0x39>;
		};

		macphy_bgs: macphy-bgs@2d {
			reg = <0x2d 0x01>;
			phandle = <0x65>;
		};

		macphy_txlevel: macphy-txlevel@2e {
			reg = <0x2e 0x02>;
			phandle = <0x66>;
		};

		vdac_out_current: vdac-out-current@30 {
			reg = <0x30 0x01>;
			phandle = <0x38>;
		};

		cpu_opp_info: cpu-opp-info@32 {
			reg = <0x32 0x06>;
			phandle = <0x0d>;
		};

		gpu_opp_info: gpu-opp-info@38 {
			reg = <0x38 0x06>;
			phandle = <0x2a>;
		};

		dmc_opp_info: dmc-opp-info@3e {
			reg = <0x3e 0x06>;
			phandle = <0x1a>;
		};
	};

	dmac: dma-controller@ffd60000 {
		compatible = "arm,pl330", "arm,primecell";
		reg = <0x00 0xffd60000 0x00 0x4000>;
		interrupts = <GIC_SPI 0 IRQ_TYPE_LEVEL_HIGH>,
		             <GIC_SPI 1 IRQ_TYPE_LEVEL_HIGH>,
		             <GIC_SPI 2 IRQ_TYPE_LEVEL_HIGH>,
		             <GIC_SPI 3 IRQ_TYPE_LEVEL_HIGH>,
		             <GIC_SPI 4 IRQ_TYPE_LEVEL_HIGH>,
		             <GIC_SPI 5 IRQ_TYPE_LEVEL_HIGH>,
		             <GIC_SPI 6 IRQ_TYPE_LEVEL_HIGH>,
		             <GIC_SPI 7 IRQ_TYPE_LEVEL_HIGH>,
		             <GIC_SPI 16 IRQ_TYPE_LEVEL_HIGH>;
		clocks = <&cru ACLK_DMAC>;
		clock-names = "apb_pclk";
		#dma-cells = <1>;
		arm,pl330-periph-burst;
		phandle = <0x3e>;
	};

	hwlock: hwspinlock@ffd70000 {
		compatible = "rockchip,hwspinlock";
		reg = <0x00 0xffd70000 0x00 0x100>;
		#hwlock-cells = <1>;
		status = "disabled";
		phandle = <0x10a>;
	};

	combphy_pu: phy@ffdc0000 {
		compatible = "rockchip,rk3528-naneng-combphy";
		reg = <0x00 0xffdc0000 0x00 0x10000>;
		#phy-cells = <1>;
		clocks = <&cru CLK_REF_PCIE_INNER_PHY>, <&cru PCLK_PCIE_PHY>, <&cru PCLK_PIPE_GRF>;
		clock-names = "refclk", "apbclk", "pipe_clk";
		assigned-clocks = <&cru CLK_REF_PCIE_INNER_PHY>;
		assigned-clock-rates = <100000000>;
		resets = <&cru SRST_PRESETN_PCIE_PHY>, <&cru SRST_RESETN_PCIE_PIPE_PHY>;
		reset-names = "combphy-apb", "combphy";
		rockchip,pipe-grf = <&grf>;
		rockchip,pipe-phy-grf = <&grf>;
		status = "okay";
		phandle = <0x20>;
	};

	usb2phy: usb2-phy@ffdf0000 {
		compatible = "rockchip,rk3528-usb2phy";
		reg = <0x00 0xffdf0000 0x00 0x10000>;
		clocks = <&cru CLK_REF_USBPHY>, <&cru PCLK_USBPHY>;
		clock-names = "phyclk", "apb_pclk";
		#clock-cells = <0>;
		rockchip,usbgrf = <&grf>;
		status = "okay";
		phandle = <0x22>;

		u2phy_otg: otg-port {
			#phy-cells = <0>;
			interrupts = <GIC_SPI 146 IRQ_TYPE_LEVEL_HIGH>,
			             <GIC_SPI 147 IRQ_TYPE_LEVEL_HIGH>,
			             <GIC_SPI 148 IRQ_TYPE_LEVEL_HIGH>;
			interrupt-names = "otg-bvalid", "otg-id", "linestate";
			status = "okay";
			vbus-supply = <&vcc5v0_otg>;
			phandle = <0x21>;
		};

		u2phy_host: host-port {
			#phy-cells = <0>;
			interrupts = <GIC_SPI 150 IRQ_TYPE_LEVEL_HIGH>;
			interrupt-names = "linestate";
			status = "okay";
			phy-supply = <&vcc5v0_host>;
			phandle = <0x23>;
		};
	};

	hdmiphy: hdmiphy@ffe00000 {
		compatible = "rockchip,rk3528-hdmi-phy";
		reg = <0x00 0xffe00000 0x00 0x10000>;
		interrupts = <GIC_SPI 101 IRQ_TYPE_LEVEL_HIGH>;
		#phy-cells = <0>;
		clocks = <&cru PCLK_HDMIPHY>, <&xin24m>;
		clock-names = "sysclk", "refclk";
		status = "okay";
		phandle = <0x3c>;

		inno_hdmiphy_clk: clk-port {
			#clock-cells = <0>;
			clock-output-names = "clk_hdmiphy_pixel_io";
			status = "okay";
			phandle = <0x31>;
		};
	};

	acodec: acodec@ffe10000 {
		compatible = "rockchip,rk3528-codec";
		reg = <0x00 0xffe10000 0x00 0x1000>;
		#sound-dai-cells = <0>;
		clocks = <&cru PCLK_ACODEC>, <&cru MCLK_ACODEC_TX>;
		clock-names = "pclk", "mclk";
		resets = <&cru SRST_PRESETN_ACODEC>;
		reset-names = "acodec";
		status = "okay";
		pa-ctl-gpios = <&gpio0 0 GPIO_ACTIVE_HIGH>;
		phandle = <0x83>;
	};

	pinctrl: pinctrl {
		compatible = "rockchip,rk3528-pinctrl";
		rockchip,grf = <&ioc_grf>;
		#address-cells = <2>;
		#size-cells = <2>;
		ranges;
		phandle = <0x79>;

		gpio0: gpio@ff610000 {
			compatible = "rockchip,gpio-bank";
			reg = <0x00 0xff610000 0x00 0x200>;
			interrupts = <GIC_SPI 71 IRQ_TYPE_LEVEL_HIGH>;
			clocks = <&cru PCLK_GPIO0>, <&cru DBCLK_GPIO0>;
			gpio-controller;
			#gpio-cells = <2>;
			gpio-ranges = <&pinctrl 0 0 32>;
			interrupt-controller;
			#interrupt-cells = <2>;
			phandle = <0x3d>;
		};

		gpio1: gpio@ffaf0000 {
			compatible = "rockchip,gpio-bank";
			reg = <0x00 0xffaf0000 0x00 0x200>;
			interrupts = <GIC_SPI 73 IRQ_TYPE_LEVEL_HIGH>;
			clocks = <&cru PCLK_GPIO1>, <&cru DBCLK_GPIO1>;
			gpio-controller;
			#gpio-cells = <2>;
			gpio-ranges = <&pinctrl 0 32 32>;
			interrupt-controller;
			#interrupt-cells = <2>;
			phandle = <0x86>;
		};

		gpio2: gpio@ffb00000 {
			compatible = "rockchip,gpio-bank";
			reg = <0x00 0xffb00000 0x00 0x200>;
			interrupts = <GIC_SPI 75 IRQ_TYPE_LEVEL_HIGH>;
			clocks = <&cru PCLK_GPIO2>, <&cru DBCLK_GPIO2>;
			gpio-controller;
			#gpio-cells = <2>;
			gpio-ranges = <&pinctrl 0 64 32>;
			interrupt-controller;
			#interrupt-cells = <2>;
			phandle = <0x10b>;
		};

		gpio3: gpio@ffb10000 {
			compatible = "rockchip,gpio-bank";
			reg = <0x00 0xffb10000 0x00 0x200>;
			interrupts = <GIC_SPI 76 IRQ_TYPE_LEVEL_HIGH>;
			clocks = <&cru PCLK_GPIO3>, <&cru DBCLK_GPIO3>;
			gpio-controller;
			#gpio-cells = <2>;
			gpio-ranges = <&pinctrl 0 96 32>;
			interrupt-controller;
			#interrupt-cells = <2>;
			phandle = <0x10c>;
		};

		gpio4: gpio@ffb20000 {
			compatible = "rockchip,gpio-bank";
			reg = <0x00 0xffb20000 0x00 0x200>;
			interrupts = <GIC_SPI 78 IRQ_TYPE_LEVEL_HIGH>;
			clocks = <&cru PCLK_GPIO4>, <&cru DBCLK_GPIO4>;
			gpio-controller;
			#gpio-cells = <2>;
			gpio-ranges = <&pinctrl 0 128 32>;
			interrupt-controller;
			#interrupt-cells = <2>;
			phandle = <0x84>;
		};

		pcfg_pull_up: pcfg-pull-up {
			bias-pull-up;
			phandle = <0x80>;
		};

		pcfg_pull_down: pcfg-pull-down {
			bias-pull-down;
			phandle = <0x81>;
		};

		pcfg_pull_none: pcfg-pull-none {
			bias-disable;
			phandle = <0x7a>;
		};

		pcfg_pull_none_drv_level_0: pcfg-pull-none-drv-level-0 {
			bias-disable;
			drive-strength = <0>;
			phandle = <0x7f>;
		};

		pcfg_pull_none_drv_level_1: pcfg-pull-none-drv-level-1 {
			bias-disable;
			drive-strength = <1>;
			phandle = <0x10d>;
		};

		pcfg_pull_none_drv_level_2: pcfg-pull-none-drv-level-2 {
			bias-disable;
			drive-strength = <2>;
			phandle = <0x7c>;
		};

		pcfg_pull_none_drv_level_3: pcfg-pull-none-drv-level-3 {
			bias-disable;
			drive-strength = <3>;
			phandle = <0x10e>;
		};

		pcfg_pull_none_drv_level_4: pcfg-pull-none-drv-level-4 {
			bias-disable;
			drive-strength = <4>;
			phandle = <0x10f>;
		};

		pcfg_pull_none_drv_level_5: pcfg-pull-none-drv-level-5 {
			bias-disable;
			drive-strength = <5>;
			phandle = <0x110>;
		};

		pcfg_pull_none_drv_level_6: pcfg-pull-none-drv-level-6 {
			bias-disable;
			drive-strength = <6>;
			phandle = <0x111>;
		};

		pcfg_pull_none_drv_level_7: pcfg-pull-none-drv-level-7 {
			bias-disable;
			drive-strength = <7>;
			phandle = <0x112>;
		};

		pcfg_pull_none_drv_level_8: pcfg-pull-none-drv-level-8 {
			bias-disable;
			drive-strength = <8>;
			phandle = <0x113>;
		};

		pcfg_pull_none_drv_level_9: pcfg-pull-none-drv-level-9 {
			bias-disable;
			drive-strength = <9>;
			phandle = <0x114>;
		};

		pcfg_pull_none_drv_level_10: pcfg-pull-none-drv-level-10 {
			bias-disable;
			drive-strength = <10>;
			phandle = <0x115>;
		};

		pcfg_pull_none_drv_level_11: pcfg-pull-none-drv-level-11 {
			bias-disable;
			drive-strength = <11>;
			phandle = <0x116>;
		};

		pcfg_pull_none_drv_level_12: pcfg-pull-none-drv-level-12 {
			bias-disable;
			drive-strength = <12>;
			phandle = <0x117>;
		};

		pcfg_pull_none_drv_level_13: pcfg-pull-none-drv-level-13 {
			bias-disable;
			drive-strength = <13>;
			phandle = <0x118>;
		};

		pcfg_pull_none_drv_level_14: pcfg-pull-none-drv-level-14 {
			bias-disable;
			drive-strength = <14>;
			phandle = <0x119>;
		};

		pcfg_pull_none_drv_level_15: pcfg-pull-none-drv-level-15 {
			bias-disable;
			drive-strength = <15>;
			phandle = <0x11a>;
		};

		pcfg_pull_up_drv_level_0: pcfg-pull-up-drv-level-0 {
			bias-pull-up;
			drive-strength = <0>;
			phandle = <0x11b>;
		};

		pcfg_pull_up_drv_level_1: pcfg-pull-up-drv-level-1 {
			bias-pull-up;
			drive-strength = <1>;
			phandle = <0x11c>;
		};

		pcfg_pull_up_drv_level_2: pcfg-pull-up-drv-level-2 {
			bias-pull-up;
			drive-strength = <2>;
			phandle = <0x7b>;
		};

		pcfg_pull_up_drv_level_3: pcfg-pull-up-drv-level-3 {
			bias-pull-up;
			drive-strength = <3>;
			phandle = <0x11d>;
		};

		pcfg_pull_up_drv_level_4: pcfg-pull-up-drv-level-4 {
			bias-pull-up;
			drive-strength = <4>;
			phandle = <0x11e>;
		};

		pcfg_pull_up_drv_level_5: pcfg-pull-up-drv-level-5 {
			bias-pull-up;
			drive-strength = <5>;
			phandle = <0x11f>;
		};

		pcfg_pull_up_drv_level_6: pcfg-pull-up-drv-level-6 {
			bias-pull-up;
			drive-strength = <6>;
			phandle = <0x120>;
		};

		pcfg_pull_up_drv_level_7: pcfg-pull-up-drv-level-7 {
			bias-pull-up;
			drive-strength = <7>;
			phandle = <0x121>;
		};

		pcfg_pull_up_drv_level_8: pcfg-pull-up-drv-level-8 {
			bias-pull-up;
			drive-strength = <8>;
			phandle = <0x122>;
		};

		pcfg_pull_up_drv_level_9: pcfg-pull-up-drv-level-9 {
			bias-pull-up;
			drive-strength = <9>;
			phandle = <0x123>;
		};

		pcfg_pull_up_drv_level_10: pcfg-pull-up-drv-level-10 {
			bias-pull-up;
			drive-strength = <10>;
			phandle = <0x124>;
		};

		pcfg_pull_up_drv_level_11: pcfg-pull-up-drv-level-11 {
			bias-pull-up;
			drive-strength = <11>;
			phandle = <0x125>;
		};

		pcfg_pull_up_drv_level_12: pcfg-pull-up-drv-level-12 {
			bias-pull-up;
			drive-strength = <12>;
			phandle = <0x126>;
		};

		pcfg_pull_up_drv_level_13: pcfg-pull-up-drv-level-13 {
			bias-pull-up;
			drive-strength = <13>;
			phandle = <0x127>;
		};

		pcfg_pull_up_drv_level_14: pcfg-pull-up-drv-level-14 {
			bias-pull-up;
			drive-strength = <14>;
			phandle = <0x128>;
		};

		pcfg_pull_up_drv_level_15: pcfg-pull-up-drv-level-15 {
			bias-pull-up;
			drive-strength = <15>;
			phandle = <0x129>;
		};

		pcfg_pull_down_drv_level_0: pcfg-pull-down-drv-level-0 {
			bias-pull-down;
			drive-strength = <0>;
			phandle = <0x12a>;
		};

		pcfg_pull_down_drv_level_1: pcfg-pull-down-drv-level-1 {
			bias-pull-down;
			drive-strength = <1>;
			phandle = <0x12b>;
		};

		pcfg_pull_down_drv_level_2: pcfg-pull-down-drv-level-2 {
			bias-pull-down;
			drive-strength = <2>;
			phandle = <0x12c>;
		};

		pcfg_pull_down_drv_level_3: pcfg-pull-down-drv-level-3 {
			bias-pull-down;
			drive-strength = <3>;
			phandle = <0x12d>;
		};

		pcfg_pull_down_drv_level_4: pcfg-pull-down-drv-level-4 {
			bias-pull-down;
			drive-strength = <4>;
			phandle = <0x12e>;
		};

		pcfg_pull_down_drv_level_5: pcfg-pull-down-drv-level-5 {
			bias-pull-down;
			drive-strength = <5>;
			phandle = <0x12f>;
		};

		pcfg_pull_down_drv_level_6: pcfg-pull-down-drv-level-6 {
			bias-pull-down;
			drive-strength = <6>;
			phandle = <0x130>;
		};

		pcfg_pull_down_drv_level_7: pcfg-pull-down-drv-level-7 {
			bias-pull-down;
			drive-strength = <7>;
			phandle = <0x131>;
		};

		pcfg_pull_down_drv_level_8: pcfg-pull-down-drv-level-8 {
			bias-pull-down;
			drive-strength = <8>;
			phandle = <0x132>;
		};

		pcfg_pull_down_drv_level_9: pcfg-pull-down-drv-level-9 {
			bias-pull-down;
			drive-strength = <9>;
			phandle = <0x133>;
		};

		pcfg_pull_down_drv_level_10: pcfg-pull-down-drv-level-10 {
			bias-pull-down;
			drive-strength = <10>;
			phandle = <0x134>;
		};

		pcfg_pull_down_drv_level_11: pcfg-pull-down-drv-level-11 {
			bias-pull-down;
			drive-strength = <11>;
			phandle = <0x135>;
		};

		pcfg_pull_down_drv_level_12: pcfg-pull-down-drv-level-12 {
			bias-pull-down;
			drive-strength = <12>;
			phandle = <0x136>;
		};

		pcfg_pull_down_drv_level_13: pcfg-pull-down-drv-level-13 {
			bias-pull-down;
			drive-strength = <13>;
			phandle = <0x137>;
		};

		pcfg_pull_down_drv_level_14: pcfg-pull-down-drv-level-14 {
			bias-pull-down;
			drive-strength = <14>;
			phandle = <0x138>;
		};

		pcfg_pull_down_drv_level_15: pcfg-pull-down-drv-level-15 {
			bias-pull-down;
			drive-strength = <15>;
			phandle = <0x139>;
		};

		pcfg_pull_up_smt: pcfg-pull-up-smt {
			bias-pull-up;
			input-schmitt-enable;
			phandle = <0x13a>;
		};

		pcfg_pull_down_smt: pcfg-pull-down-smt {
			bias-pull-down;
			input-schmitt-enable;
			phandle = <0x13b>;
		};

		pcfg_pull_none_smt: pcfg-pull-none-smt {
			bias-disable;
			input-schmitt-enable;
			phandle = <0x7e>;
		};

		pcfg_pull_none_drv_level_0_smt: pcfg-pull-none-drv-level-0-smt {
			bias-disable;
			drive-strength = <0>;
			input-schmitt-enable;
			phandle = <0x13c>;
		};

		pcfg_pull_none_drv_level_1_smt: pcfg-pull-none-drv-level-1-smt {
			bias-disable;
			drive-strength = <1>;
			input-schmitt-enable;
			phandle = <0x13d>;
		};

		pcfg_pull_none_drv_level_2_smt: pcfg-pull-none-drv-level-2-smt {
			bias-disable;
			drive-strength = <2>;
			input-schmitt-enable;
			phandle = <0x13e>;
		};

		pcfg_pull_none_drv_level_3_smt: pcfg-pull-none-drv-level-3-smt {
			bias-disable;
			drive-strength = <3>;
			input-schmitt-enable;
			phandle = <0x13f>;
		};

		pcfg_pull_none_drv_level_4_smt: pcfg-pull-none-drv-level-4-smt {
			bias-disable;
			drive-strength = <4>;
			input-schmitt-enable;
			phandle = <0x140>;
		};

		pcfg_pull_none_drv_level_5_smt: pcfg-pull-none-drv-level-5-smt {
			bias-disable;
			drive-strength = <5>;
			input-schmitt-enable;
			phandle = <0x141>;
		};

		pcfg_output_high: pcfg-output-high {
			output-high;
			phandle = <0x142>;
		};

		pcfg_output_high_pull_up: pcfg-output-high-pull-up {
			output-high;
			bias-pull-up;
			phandle = <0x143>;
		};

		pcfg_output_high_pull_down: pcfg-output-high-pull-down {
			output-high;
			bias-pull-down;
			phandle = <0x144>;
		};

		pcfg_output_high_pull_none: pcfg-output-high-pull-none {
			output-high;
			bias-disable;
			phandle = <0x145>;
		};

		pcfg_output_low: pcfg-output-low {
			output-low;
			phandle = <0x146>;
		};

		pcfg_output_low_pull_up: pcfg-output-low-pull-up {
			output-low;
			bias-pull-up;
			phandle = <0x147>;
		};

		pcfg_output_low_pull_down: pcfg-output-low-pull-down {
			output-low;
			bias-pull-down;
			phandle = <0x7d>;
		};

		pcfg_output_low_pull_none: pcfg-output-low-pull-none {
			output-low;
			bias-disable;
			phandle = <0x148>;
		};

		arm {

			arm_pins: arm-pins {
				rockchip,pins = <4 RK_PC4 3 &pcfg_pull_none>;
				phandle = <0x149>;
			};
		};

		clk {

			clkm0_32k_out: clkm0-32k-out {
				rockchip,pins = <3 RK_PC3 3 &pcfg_pull_none>;
				phandle = <0x14a>;
			};

			clkm1_32k_out: clkm1-32k-out {
				rockchip,pins = <1 RK_PC3 1 &pcfg_pull_none>;
				phandle = <0x96>;
			};
		};

		emmc {

			emmc_rstnout: emmc-rstnout {
				rockchip,pins = <1 RK_PD6 1 &pcfg_pull_none>;
				phandle = <0x14b>;
			};

			emmc_bus8: emmc-bus8 {
				rockchip,pins = <1 RK_PC4 1 &pcfg_pull_up_drv_level_2>,
				                <1 RK_PC5 1 &pcfg_pull_up_drv_level_2>,
				                <1 RK_PC6 1 &pcfg_pull_up_drv_level_2>,
				                <1 RK_PC7 1 &pcfg_pull_up_drv_level_2>,
				                <1 RK_PD0 1 &pcfg_pull_up_drv_level_2>,
				                <1 RK_PD1 1 &pcfg_pull_up_drv_level_2>,
				                <1 RK_PD2 1 &pcfg_pull_up_drv_level_2>,
				                <1 RK_PD3 1 &pcfg_pull_up_drv_level_2>;
				phandle = <0x14c>;
			};

			emmc_clk: emmc-clk {
				rockchip,pins = <1 RK_PD5 1 &pcfg_pull_up_drv_level_2>;
				phandle = <0x14d>;
			};

			emmc_cmd: emmc-cmd {
				rockchip,pins = <1 RK_PD4 1 &pcfg_pull_up_drv_level_2>;
				phandle = <0x14e>;
			};

			emmc_strb: emmc-strb {
				rockchip,pins = <1 RK_PD7 1 &pcfg_pull_none>;
				phandle = <0x14f>;
			};
		};

		eth {

			eth_pins: eth-pins {
				rockchip,pins = <3 RK_PB5 2 &pcfg_pull_none_drv_level_2>;
				phandle = <0x150>;
			};
		};

		fephy {

			fephym0_led_dpx: fephym0-led_dpx {
				rockchip,pins = <4 RK_PB5 2 &pcfg_pull_none>;
				phandle = <0x151>;
			};

			fephym0_led_link: fephym0-led_link {
				rockchip,pins = <4 RK_PC0 2 &pcfg_pull_none>;
				phandle = <0x152>;
			};

			fephym0_led_spd: fephym0-led_spd {
				rockchip,pins = <4 RK_PB7 2 &pcfg_pull_none>;
				phandle = <0x153>;
			};

			fephym1_led_dpx: fephym1-led_dpx {
				rockchip,pins = <2 RK_PA4 5 &pcfg_pull_none>;
				phandle = <0x154>;
			};

			fephym1_led_link: fephym1-led_link {
				rockchip,pins = <2 RK_PA6 5 &pcfg_pull_none>;
				phandle = <0x155>;
			};

			fephym1_led_spd: fephym1-led_spd {
				rockchip,pins = <2 RK_PA5 5 &pcfg_pull_none>;
				phandle = <0x156>;
			};
		};

		fspi {

			fspi_pins: fspi-pins {
				rockchip,pins = <1 RK_PD5 2 &pcfg_pull_none>,
				                <1 RK_PC4 2 &pcfg_pull_none>,
				                <1 RK_PC5 2 &pcfg_pull_none>,
				                <1 RK_PC6 2 &pcfg_pull_none>,
				                <1 RK_PC7 2 &pcfg_pull_none>;
				phandle = <0x157>;
			};

			fspi_csn0: fspi-csn0 {
				rockchip,pins = <1 RK_PD0 2 &pcfg_pull_none>;
				phandle = <0x158>;
			};

			fspi_csn1: fspi-csn1 {
				rockchip,pins = <1 RK_PD1 2 &pcfg_pull_none>;
				phandle = <0x159>;
			};
		};

		gpu {

			gpu_pins: gpu-pins {
				rockchip,pins = <4 RK_PC3 3 &pcfg_pull_none>;
				phandle = <0x15a>;
			};
		};

		hdmi {

			hdmi_pins: hdmi-pins {
				rockchip,pins = <0 RK_PA3 1 &pcfg_pull_none>,
				                <0 RK_PA4 1 &pcfg_pull_none>,
				                <0 RK_PA5 1 &pcfg_pull_none>;
				phandle = <0x3a>;
			};

			hdmi_pins_idle: hdmi-pins-idle {
				rockchip,pins = <0 RK_PA3 1 &pcfg_pull_none>,
				                <0 RK_PA4 RK_FUNC_GPIO &pcfg_output_low_pull_down>,
				                <0 RK_PA5 RK_FUNC_GPIO &pcfg_output_low_pull_down>;
				phandle = <0x3b>;
			};
		};

		hsm {

			hsmm0_pins: hsmm0-pins {
				rockchip,pins = <2 RK_PA2 4 &pcfg_pull_none>;
				phandle = <0x15b>;
			};

			hsmm1_pins: hsmm1-pins {
				rockchip,pins = <1 RK_PA4 3 &pcfg_pull_none>;
				phandle = <0x15c>;
			};
		};

		i2c0 {

			i2c0m0_xfer: i2c0m0-xfer {
				rockchip,pins = <4 RK_PC4 2 &pcfg_pull_none_smt>,
				                <4 RK_PC3 2 &pcfg_pull_none_smt>;
				phandle = <0x47>;
			};

			i2c0m1_xfer: i2c0m1-xfer {
				rockchip,pins = <4 RK_PA1 2 &pcfg_pull_none_smt>,
				                <4 RK_PA0 2 &pcfg_pull_none_smt>;
				phandle = <0x15d>;
			};
		};

		i2c1 {

			i2c1m0_xfer: i2c1m0-xfer {
				rockchip,pins = <4 RK_PA3 2 &pcfg_pull_none_smt>,
				                <4 RK_PA2 2 &pcfg_pull_none_smt>;
				phandle = <0x48>;
			};

			i2c1m1_xfer: i2c1m1-xfer {
				rockchip,pins = <4 RK_PC5 4 &pcfg_pull_none_smt>,
				                <4 RK_PC6 4 &pcfg_pull_none_smt>;
				phandle = <0x15e>;
			};
		};

		i2c2 {

			i2c2m0_xfer: i2c2m0-xfer {
				rockchip,pins = <0 RK_PA4 2 &pcfg_pull_none_smt>,
				                <0 RK_PA5 2 &pcfg_pull_none_smt>;
				phandle = <0x49>;
			};

			i2c2m1_xfer: i2c2m1-xfer {
				rockchip,pins = <1 RK_PA5 3 &pcfg_pull_none_smt>,
				                <1 RK_PA6 3 &pcfg_pull_none_smt>;
				phandle = <0x15f>;
			};
		};

		i2c3 {

			i2c3m0_xfer: i2c3m0-xfer {
				rockchip,pins = <1 RK_PA0 2 &pcfg_pull_none_smt>,
				                <1 RK_PA1 2 &pcfg_pull_none_smt>;
				phandle = <0x4a>;
			};

			i2c3m1_xfer: i2c3m1-xfer {
				rockchip,pins = <3 RK_PC1 5 &pcfg_pull_none_smt>,
				                <3 RK_PC3 5 &pcfg_pull_none_smt>;
				phandle = <0x160>;
			};
		};

		i2c4 {

			i2c4_xfer: i2c4-xfer {
				rockchip,pins = <2 RK_PA0 4 &pcfg_pull_none_smt>,
				                <2 RK_PA1 4 &pcfg_pull_none_smt>;
				phandle = <0x4b>;
			};
		};

		i2c5 {

			i2c5m0_xfer: i2c5m0-xfer {
				rockchip,pins = <1 RK_PB2 3 &pcfg_pull_none_smt>,
				                <1 RK_PB3 3 &pcfg_pull_none_smt>;
				phandle = <0x4c>;
			};

			i2c5m1_xfer: i2c5m1-xfer {
				rockchip,pins = <1 RK_PD2 3 &pcfg_pull_none_smt>,
				                <1 RK_PD3 3 &pcfg_pull_none_smt>;
				phandle = <0x161>;
			};
		};

		i2c6 {

			i2c6m0_xfer: i2c6m0-xfer {
				rockchip,pins = <3 RK_PB2 5 &pcfg_pull_none_smt>,
				                <3 RK_PB3 5 &pcfg_pull_none_smt>;
				phandle = <0x4d>;
			};

			i2c6m1_xfer: i2c6m1-xfer {
				rockchip,pins = <1 RK_PD4 3 &pcfg_pull_none_smt>,
				                <1 RK_PD7 3 &pcfg_pull_none_smt>;
				phandle = <0x162>;
			};
		};

		i2c7 {

			i2c7_xfer: i2c7-xfer {
				rockchip,pins = <2 RK_PA5 4 &pcfg_pull_none_smt>,
				                <2 RK_PA6 4 &pcfg_pull_none_smt>;
				phandle = <0x4e>;
			};
		};

		i2s0 {

			i2s0m0_pins: i2s0m0-pins {
				rockchip,pins = <3 RK_PB6 1 &pcfg_pull_none>,
				                <3 RK_PB4 1 &pcfg_pull_none>,
				                <3 RK_PB5 1 &pcfg_pull_none>,
				                <3 RK_PB7 1 &pcfg_pull_none>,
				                <3 RK_PC0 1 &pcfg_pull_none>;
				phandle = <0x58>;
			};

			i2s0m1_pins: i2s0m1-pins {
				rockchip,pins = <1 RK_PB6 1 &pcfg_pull_none>,
				                <1 RK_PB4 1 &pcfg_pull_none>,
				                <1 RK_PB5 1 &pcfg_pull_none>,
				                <1 RK_PB7 1 &pcfg_pull_none>,
				                <1 RK_PC0 1 &pcfg_pull_none>;
				phandle = <0x163>;
			};
		};

		i2s1 {

			i2s1_pins: i2s1-pins {
				rockchip,pins = <4 RK_PA6 1 &pcfg_pull_none>,
				                <4 RK_PA4 1 &pcfg_pull_none>,
				                <4 RK_PA5 1 &pcfg_pull_none>,
				                <4 RK_PB4 1 &pcfg_pull_none>,
				                <4 RK_PB3 1 &pcfg_pull_none>,
				                <4 RK_PA3 1 &pcfg_pull_none>,
				                <4 RK_PA2 1 &pcfg_pull_none>,
				                <4 RK_PA7 1 &pcfg_pull_none>,
				                <4 RK_PB0 1 &pcfg_pull_none>,
				                <4 RK_PB1 1 &pcfg_pull_none>,
				                <4 RK_PB2 1 &pcfg_pull_none>;
				phandle = <0x59>;
			};
		};

		jtag {

			jtagm0_pins: jtagm0-pins {
				rockchip,pins = <2 RK_PA2 2 &pcfg_pull_none>,
				                <2 RK_PA3 2 &pcfg_pull_none>,
				                <2 RK_PA4 2 &pcfg_pull_none>,
				                <2 RK_PA5 2 &pcfg_pull_none>;
				phandle = <0x164>;
			};

			jtagm1_pins: jtagm1-pins {
				rockchip,pins = <4 RK_PD0 2 &pcfg_pull_none>,
				                <4 RK_PC7 2 &pcfg_pull_none>,
				                <4 RK_PD0 3 &pcfg_pull_none>,
				                <4 RK_PC7 3 &pcfg_pull_none>;
				phandle = <0x165>;
			};
		};

		pcie {

			pciem0_pins: pciem0-pins {
				rockchip,pins = <3 RK_PA6 5 &pcfg_pull_none>,
				                <3 RK_PB0 5 &pcfg_pull_none>,
				                <3 RK_PA7 5 &pcfg_pull_none>;
				phandle = <0x166>;
			};

			pciem1_pins: pciem1-pins {
				rockchip,pins = <1 RK_PA0 4 &pcfg_pull_none>,
				                <1 RK_PA2 4 &pcfg_pull_none>,
				                <1 RK_PA1 4 &pcfg_pull_none>;
				phandle = <0x167>;
			};
		};

		pdm {

			pdm_clk0: pdm-clk0 {
				rockchip,pins = <4 RK_PB5 3 &pcfg_pull_none>;
				phandle = <0x5a>;
			};

			pdm_clk1: pdm-clk1 {
				rockchip,pins = <4 RK_PA4 3 &pcfg_pull_none>;
				phandle = <0x5b>;
			};

			pdm_sdi0: pdm-sdi0 {
				rockchip,pins = <4 RK_PB2 3 &pcfg_pull_none>;
				phandle = <0x5c>;
			};

			pdm_sdi1: pdm-sdi1 {
				rockchip,pins = <4 RK_PB1 3 &pcfg_pull_none>;
				phandle = <0x5d>;
			};

			pdm_sdi2: pdm-sdi2 {
				rockchip,pins = <4 RK_PB3 3 &pcfg_pull_none>;
				phandle = <0x5e>;
			};

			pdm_sdi3: pdm-sdi3 {
				rockchip,pins = <4 RK_PC1 3 &pcfg_pull_none>;
				phandle = <0x5f>;
			};
		};

		pmu {

			pmu_pins: pmu-pins {
				rockchip,pins = <4 RK_PA0 4 &pcfg_pull_none>;
				phandle = <0x168>;
			};
		};

		pwm0 {

			pwm0m0_pins: pwm0m0-pins {
				rockchip,pins = <4 RK_PC3 1 &pcfg_pull_none_drv_level_0>;
				phandle = <0x4f>;
			};

			pwm0m1_pins: pwm0m1-pins {
				rockchip,pins = <1 RK_PA2 5 &pcfg_pull_none_drv_level_0>;
				phandle = <0x169>;
			};
		};

		pwm1 {

			pwm1m0_pins: pwm1m0-pins {
				rockchip,pins = <4 RK_PC4 1 &pcfg_pull_none_drv_level_0>;
				phandle = <0x50>;
			};

			pwm1m1_pins: pwm1m1-pins {
				rockchip,pins = <1 RK_PA3 4 &pcfg_pull_none_drv_level_0>;
				phandle = <0x16a>;
			};
		};

		pwm2 {

			pwm2m0_pins: pwm2m0-pins {
				rockchip,pins = <4 RK_PC5 1 &pcfg_pull_none_drv_level_0>;
				phandle = <0x51>;
			};

			pwm2m1_pins: pwm2m1-pins {
				rockchip,pins = <1 RK_PA7 2 &pcfg_pull_none_drv_level_0>;
				phandle = <0x16b>;
			};
		};

		pwm3 {

			pwm3m0_pins: pwm3m0-pins {
				rockchip,pins = <4 RK_PC6 1 &pcfg_pull_none_drv_level_0>;
				phandle = <0x52>;
			};

			pwm3m1_pins: pwm3m1-pins {
				rockchip,pins = <2 RK_PA4 3 &pcfg_pull_none_drv_level_0>;
				phandle = <0x16c>;
			};
		};

		pwm4 {

			pwm4m0_pins: pwm4m0-pins {
				rockchip,pins = <4 RK_PB7 1 &pcfg_pull_none_drv_level_0>;
				phandle = <0x53>;
			};

			pwm4m1_pins: pwm4m1-pins {
				rockchip,pins = <1 RK_PA4 2 &pcfg_pull_none_drv_level_0>;
				phandle = <0x16d>;
			};
		};

		pwm5 {

			pwm5m0_pins: pwm5m0-pins {
				rockchip,pins = <4 RK_PC0 1 &pcfg_pull_none_drv_level_0>;
				phandle = <0x54>;
			};

			pwm5m1_pins: pwm5m1-pins {
				rockchip,pins = <3 RK_PC3 1 &pcfg_pull_none_drv_level_0>;
				phandle = <0x16e>;
			};
		};

		pwm6 {

			pwm6m0_pins: pwm6m0-pins {
				rockchip,pins = <4 RK_PC1 1 &pcfg_pull_none_drv_level_0>;
				phandle = <0x55>;
			};

			pwm6m1_pins: pwm6m1-pins {
				rockchip,pins = <1 RK_PC3 3 &pcfg_pull_none_drv_level_0>;
				phandle = <0x16f>;
			};

			pwm6m2_pins: pwm6m2-pins {
				rockchip,pins = <3 RK_PC1 1 &pcfg_pull_none_drv_level_0>;
				phandle = <0x170>;
			};
		};

		pwm7 {

			pwm7m0_pins: pwm7m0-pins {
				rockchip,pins = <4 RK_PC2 1 &pcfg_pull_none_drv_level_0>;
				phandle = <0x56>;
			};

			pwm7m1_pins: pwm7m1-pins {
				rockchip,pins = <1 RK_PC2 2 &pcfg_pull_none_drv_level_0>;
				phandle = <0x171>;
			};
		};

		pwr {

			pwr_pins: pwr-pins {
				rockchip,pins = <4 RK_PC2 2 &pcfg_pull_none>,
				                <4 RK_PB6 1 &pcfg_pull_none>;
				phandle = <0x172>;
			};
		};

		ref {

			refm0_pins: refm0-pins {
				rockchip,pins = <0 RK_PA1 1 &pcfg_pull_none>;
				phandle = <0x173>;
			};

			refm1_pins: refm1-pins {
				rockchip,pins = <3 RK_PC3 6 &pcfg_pull_none>;
				phandle = <0x174>;
			};
		};

		rgmii {

			rgmii_miim: rgmii-miim {
				rockchip,pins = <3 RK_PB6 2 &pcfg_pull_none_drv_level_2>,
				                <3 RK_PB7 2 &pcfg_pull_none_drv_level_2>;
				phandle = <0x175>;
			};

			rgmii_rx_bus2: rgmii-rx_bus2 {
				rockchip,pins = <3 RK_PA3 2 &pcfg_pull_none>,
				                <3 RK_PA2 2 &pcfg_pull_none>,
				                <3 RK_PC2 2 &pcfg_pull_none>;
				phandle = <0x176>;
			};

			rgmii_tx_bus2: rgmii-tx_bus2 {
				rockchip,pins = <3 RK_PA1 2 &pcfg_pull_none_drv_level_2>,
				                <3 RK_PA0 2 &pcfg_pull_none_drv_level_2>,
				                <3 RK_PC0 2 &pcfg_pull_none>;
				phandle = <0x177>;
			};

			rgmii_rgmii_clk: rgmii-rgmii_clk {
				rockchip,pins = <3 RK_PA5 2 &pcfg_pull_none>,
				                <3 RK_PA4 2 &pcfg_pull_none_drv_level_2>;
				phandle = <0x178>;
			};

			rgmii_rgmii_bus: rgmii-rgmii_bus {
				rockchip,pins = <3 RK_PA7 2 &pcfg_pull_none>,
				                <3 RK_PA6 2 &pcfg_pull_none>,
				                <3 RK_PB1 2 &pcfg_pull_none_drv_level_2>,
				                <3 RK_PB0 2 &pcfg_pull_none_drv_level_2>;
				phandle = <0x179>;
			};

			rgmii_clk: rgmii-clk {
				rockchip,pins = <3 RK_PB4 2 &pcfg_pull_none>;
				phandle = <0x17a>;
			};

			rgmii_txer: rgmii-txer {
				rockchip,pins = <3 RK_PC1 2 &pcfg_pull_none>;
				phandle = <0x17b>;
			};
		};

		scr {

			scrm0_pins: scrm0-pins {
				rockchip,pins = <1 RK_PA2 3 &pcfg_pull_none>,
				                <1 RK_PA1 3 &pcfg_pull_none>,
				                <1 RK_PA0 3 &pcfg_pull_none>,
				                <1 RK_PA3 3 &pcfg_pull_none>;
				phandle = <0x17c>;
			};

			scrm1_pins: scrm1-pins {
				rockchip,pins = <2 RK_PA5 3 &pcfg_pull_none>,
				                <2 RK_PA3 4 &pcfg_pull_none>,
				                <2 RK_PA6 3 &pcfg_pull_none>,
				                <2 RK_PA4 4 &pcfg_pull_none>;
				phandle = <0x17d>;
			};
		};

		sdio0 {

			sdio0_bus4: sdio0-bus4 {
				rockchip,pins = <1 RK_PA0 1 &pcfg_pull_up_drv_level_2>,
				                <1 RK_PA1 1 &pcfg_pull_up_drv_level_2>,
				                <1 RK_PA2 1 &pcfg_pull_up_drv_level_2>,
				                <1 RK_PA3 1 &pcfg_pull_up_drv_level_2>;
				phandle = <0x6c>;
			};

			sdio0_clk: sdio0-clk {
				rockchip,pins = <1 RK_PA5 1 &pcfg_pull_up_drv_level_2>;
				phandle = <0x6e>;
			};

			sdio0_cmd: sdio0-cmd {
				rockchip,pins = <1 RK_PA4 1 &pcfg_pull_up_drv_level_2>;
				phandle = <0x6d>;
			};

			sdio0_det: sdio0-det {
				rockchip,pins = <1 RK_PA6 1 &pcfg_pull_up>;
				phandle = <0x17e>;
			};

			sdio0_pwren: sdio0-pwren {
				rockchip,pins = <1 RK_PA7 1 &pcfg_pull_none>;
				phandle = <0x17f>;
			};
		};

		sdio1 {

			sdio1_bus4: sdio1-bus4 {
				rockchip,pins = <3 RK_PA6 1 &pcfg_pull_up_drv_level_2>,
				                <3 RK_PA7 1 &pcfg_pull_up_drv_level_2>,
				                <3 RK_PB0 1 &pcfg_pull_up_drv_level_2>,
				                <3 RK_PB1 1 &pcfg_pull_up_drv_level_2>;
				phandle = <0x180>;
			};

			sdio1_clk: sdio1-clk {
				rockchip,pins = <3 RK_PA4 1 &pcfg_pull_up_drv_level_2>;
				phandle = <0x181>;
			};

			sdio1_cmd: sdio1-cmd {
				rockchip,pins = <3 RK_PA5 1 &pcfg_pull_up_drv_level_2>;
				phandle = <0x182>;
			};

			sdio1_det: sdio1-det {
				rockchip,pins = <3 RK_PB3 1 &pcfg_pull_up>;
				phandle = <0x183>;
			};

			sdio1_pwren: sdio1-pwren {
				rockchip,pins = <3 RK_PB2 1 &pcfg_pull_none>;
				phandle = <0x184>;
			};
		};

		sdmmc {

			sdmmc_bus4: sdmmc-bus4 {
				rockchip,pins = <2 RK_PA0 1 &pcfg_pull_up_drv_level_2>,
				                <2 RK_PA1 1 &pcfg_pull_up_drv_level_2>,
				                <2 RK_PA2 1 &pcfg_pull_up_drv_level_2>,
				                <2 RK_PA3 1 &pcfg_pull_up_drv_level_2>;
				phandle = <0x72>;
			};

			sdmmc_clk: sdmmc-clk {
				rockchip,pins = <2 RK_PA5 1 &pcfg_pull_up_drv_level_2>;
				phandle = <0x6f>;
			};

			sdmmc_cmd: sdmmc-cmd {
				rockchip,pins = <2 RK_PA4 1 &pcfg_pull_up_drv_level_2>;
				phandle = <0x70>;
			};

			sdmmc_det: sdmmc-det {
				rockchip,pins = <2 RK_PA6 1 &pcfg_pull_up>;
				phandle = <0x71>;
			};

			sdmmc_pwren: sdmmc-pwren {
				rockchip,pins = <4 RK_PA1 1 &pcfg_pull_none>;
				phandle = <0x185>;
			};
		};

		spdif {

			spdifm0_pins: spdifm0-pins {
				rockchip,pins = <4 RK_PA0 1 &pcfg_pull_none>;
				phandle = <0x60>;
			};

			spdifm1_pins: spdifm1-pins {
				rockchip,pins = <1 RK_PC3 2 &pcfg_pull_none>;
				phandle = <0x186>;
			};

			spdifm2_pins: spdifm2-pins {
				rockchip,pins = <3 RK_PC3 2 &pcfg_pull_none>;
				phandle = <0x187>;
			};
		};

		spi0 {

			spi0_pins: spi0-pins {
				rockchip,pins = <4 RK_PB4 2 &pcfg_pull_none>,
				                <4 RK_PB3 2 &pcfg_pull_none>,
				                <4 RK_PB2 2 &pcfg_pull_none>;
				phandle = <0x41>;
			};

			spi0_csn0: spi0-csn0 {
				rockchip,pins = <4 RK_PB6 2 &pcfg_pull_none>;
				phandle = <0x3f>;
			};

			spi0_csn1: spi0-csn1 {
				rockchip,pins = <4 RK_PC1 2 &pcfg_pull_none>;
				phandle = <0x40>;
			};
		};

		spi1 {

			spi1_pins: spi1-pins {
				rockchip,pins = <1 RK_PB6 2 &pcfg_pull_none>,
				                <1 RK_PC0 2 &pcfg_pull_none>,
				                <1 RK_PB7 2 &pcfg_pull_none>;
				phandle = <0x44>;
			};

			spi1_csn0: spi1-csn0 {
				rockchip,pins = <1 RK_PC1 1 &pcfg_pull_none>;
				phandle = <0x42>;
			};

			spi1_csn1: spi1-csn1 {
				rockchip,pins = <1 RK_PC2 1 &pcfg_pull_none>;
				phandle = <0x43>;
			};
		};

		tsi0 {

			tsi0_pins: tsi0-pins {
				rockchip,pins = <3 RK_PB2 3 &pcfg_pull_none>,
				                <3 RK_PB1 3 &pcfg_pull_none>,
				                <3 RK_PB5 3 &pcfg_pull_none>,
				                <3 RK_PB6 3 &pcfg_pull_none>,
				                <3 RK_PB7 3 &pcfg_pull_none>,
				                <3 RK_PA3 3 &pcfg_pull_none>,
				                <3 RK_PA2 3 &pcfg_pull_none>,
				                <3 RK_PA1 3 &pcfg_pull_none>,
				                <3 RK_PA0 3 &pcfg_pull_none>,
				                <3 RK_PC0 3 &pcfg_pull_none>,
				                <3 RK_PB4 3 &pcfg_pull_none>,
				                <3 RK_PB3 3 &pcfg_pull_none>;
				phandle = <0x188>;
			};
		};

		tsi1 {

			tsi1_pins: tsi1-pins {
				rockchip,pins = <3 RK_PA5 3 &pcfg_pull_none>,
				                <3 RK_PA4 3 &pcfg_pull_none>,
				                <3 RK_PA7 3 &pcfg_pull_none>,
				                <3 RK_PA6 3 &pcfg_pull_none>;
				phandle = <0x189>;
			};
		};

		uart0 {

			uart0m0_xfer: uart0m0-xfer {
				rockchip,pins = <4 RK_PC7 1 &pcfg_pull_up>,
				                <4 RK_PD0 1 &pcfg_pull_up>;
				phandle = <0x9a>;
			};

			uart0m1_xfer: uart0m1-xfer {
				rockchip,pins = <2 RK_PA0 2 &pcfg_pull_up>,
				                <2 RK_PA1 2 &pcfg_pull_up>;
				phandle = <0x18a>;
			};
		};

		uart1 {

			uart1m0_xfer: uart1m0-xfer {
				rockchip,pins = <4 RK_PA7 2 &pcfg_pull_up>,
				                <4 RK_PA6 2 &pcfg_pull_up>;
				phandle = <0x18b>;
			};

			uart1m1_xfer: uart1m1-xfer {
				rockchip,pins = <4 RK_PC6 2 &pcfg_pull_up>,
				                <4 RK_PC5 2 &pcfg_pull_up>;
				phandle = <0x18c>;
			};

			uart1_ctsn: uart1-ctsn {
				rockchip,pins = <4 RK_PA4 2 &pcfg_pull_none>;
				phandle = <0x18d>;
			};

			uart1_rtsn: uart1-rtsn {
				rockchip,pins = <4 RK_PA5 2 &pcfg_pull_none>;
				phandle = <0x18e>;
			};
		};

		uart2 {

			uart2m0_xfer: uart2m0-xfer {
				rockchip,pins = <3 RK_PA0 1 &pcfg_pull_up>,
				                <3 RK_PA1 1 &pcfg_pull_up>;
				phandle = <0x18f>;
			};

			uart2m0_ctsn: uart2m0-ctsn {
				rockchip,pins = <3 RK_PA3 1 &pcfg_pull_none>;
				phandle = <0x190>;
			};

			uart2m0_rtsn: uart2m0-rtsn {
				rockchip,pins = <3 RK_PA2 1 &pcfg_pull_none>;
				phandle = <0x191>;
			};

			uart2m1_xfer: uart2m1-xfer {
				rockchip,pins = <1 RK_PB0 1 &pcfg_pull_up>,
				                <1 RK_PB1 1 &pcfg_pull_up>;
				phandle = <0x45>;
			};

			uart2m1_ctsn: uart2m1-ctsn {
				rockchip,pins = <1 RK_PB3 1 &pcfg_pull_none>;
				phandle = <0x46>;
			};

			uart2m1_rtsn: uart2m1-rtsn {
				rockchip,pins = <1 RK_PB2 1 &pcfg_pull_none>;
				phandle = <0x97>;
			};
		};

		uart3 {

			uart3m0_xfer: uart3m0-xfer {
				rockchip,pins = <4 RK_PB0 2 &pcfg_pull_up>,
				                <4 RK_PB1 2 &pcfg_pull_up>;
				phandle = <0x192>;
			};

			uart3m1_xfer: uart3m1-xfer {
				rockchip,pins = <4 RK_PB7 3 &pcfg_pull_up>,
				                <4 RK_PC0 3 &pcfg_pull_up>;
				phandle = <0x193>;
			};

			uart3_ctsn: uart3-ctsn {
				rockchip,pins = <4 RK_PA3 3 &pcfg_pull_none>;
				phandle = <0x194>;
			};

			uart3_rtsn: uart3-rtsn {
				rockchip,pins = <4 RK_PA2 3 &pcfg_pull_none>;
				phandle = <0x195>;
			};
		};

		uart4 {

			uart4_xfer: uart4-xfer {
				rockchip,pins = <2 RK_PA2 3 &pcfg_pull_up>,
				                <2 RK_PA3 3 &pcfg_pull_up>;
				phandle = <0x196>;
			};

			uart4_ctsn: uart4-ctsn {
				rockchip,pins = <2 RK_PA1 3 &pcfg_pull_none>;
				phandle = <0x197>;
			};

			uart4_rtsn: uart4-rtsn {
				rockchip,pins = <2 RK_PA0 3 &pcfg_pull_none>;
				phandle = <0x198>;
			};
		};

		uart5 {

			uart5m0_xfer: uart5m0-xfer {
				rockchip,pins = <1 RK_PA2 2 &pcfg_pull_up>,
				                <1 RK_PA3 2 &pcfg_pull_up>;
				phandle = <0x199>;
			};

			uart5m0_ctsn: uart5m0-ctsn {
				rockchip,pins = <1 RK_PA6 2 &pcfg_pull_none>;
				phandle = <0x19a>;
			};

			uart5m0_rtsn: uart5m0-rtsn {
				rockchip,pins = <1 RK_PA5 2 &pcfg_pull_none>;
				phandle = <0x19b>;
			};

			uart5m1_xfer: uart5m1-xfer {
				rockchip,pins = <1 RK_PD4 2 &pcfg_pull_up>,
				                <1 RK_PD7 2 &pcfg_pull_up>;
				phandle = <0x19c>;
			};

			uart5m1_ctsn: uart5m1-ctsn {
				rockchip,pins = <1 RK_PD3 2 &pcfg_pull_none>;
				phandle = <0x19d>;
			};

			uart5m1_rtsn: uart5m1-rtsn {
				rockchip,pins = <1 RK_PD2 2 &pcfg_pull_none>;
				phandle = <0x19e>;
			};
		};

		uart6 {

			uart6m0_xfer: uart6m0-xfer {
				rockchip,pins = <3 RK_PA7 4 &pcfg_pull_up>,
				                <3 RK_PA6 4 &pcfg_pull_up>;
				phandle = <0x19f>;
			};

			uart6m1_xfer: uart6m1-xfer {
				rockchip,pins = <3 RK_PC3 4 &pcfg_pull_up>,
				                <3 RK_PC1 4 &pcfg_pull_up>;
				phandle = <0x1a0>;
			};

			uart6_ctsn: uart6-ctsn {
				rockchip,pins = <3 RK_PA4 4 &pcfg_pull_none>;
				phandle = <0x1a1>;
			};

			uart6_rtsn: uart6-rtsn {
				rockchip,pins = <3 RK_PA5 4 &pcfg_pull_none>;
				phandle = <0x1a2>;
			};
		};

		uart7 {

			uart7m0_xfer: uart7m0-xfer {
				rockchip,pins = <3 RK_PB3 4 &pcfg_pull_up>,
				                <3 RK_PB2 4 &pcfg_pull_up>;
				phandle = <0x1a3>;
			};

			uart7m0_ctsn: uart7m0-ctsn {
				rockchip,pins = <3 RK_PB0 4 &pcfg_pull_none>;
				phandle = <0x1a4>;
			};

			uart7m0_rtsn: uart7m0-rtsn {
				rockchip,pins = <3 RK_PB1 4 &pcfg_pull_none>;
				phandle = <0x1a5>;
			};

			uart7m1_xfer: uart7m1-xfer {
				rockchip,pins = <1 RK_PB3 4 &pcfg_pull_up>,
				                <1 RK_PB2 4 &pcfg_pull_up>;
				phandle = <0x1a6>;
			};

			uart7m1_ctsn: uart7m1-ctsn {
				rockchip,pins = <1 RK_PB0 4 &pcfg_pull_none>;
				phandle = <0x1a7>;
			};

			uart7m1_rtsn: uart7m1-rtsn {
				rockchip,pins = <1 RK_PB1 4 &pcfg_pull_none>;
				phandle = <0x1a8>;
			};
		};

		usb {

			vcc5v0_host_en: vcc5v0-host-en {
				rockchip,pins = <4 RK_PB5 RK_FUNC_GPIO &pcfg_pull_none>;
				phandle = <0x8f>;
			};

			vcc5v0_otg_en: vcc5v0-otg-en {
				rockchip,pins = <4 RK_PC1 RK_FUNC_GPIO &pcfg_pull_none>;
				phandle = <0x90>;
			};
		};

		sdio-pwrseq {

			wifi_enable_h: wifi-enable-h {
				rockchip,pins = <4 RK_PA4 RK_FUNC_GPIO &pcfg_pull_none>;
				phandle = <0x95>;
			};

			wifi_32k: wifi-32k {
				rockchip,pins = <1 RK_PC3 1 &pcfg_pull_none>;
				phandle = <0x1a9>;
			};
		};

		wireless-wlan {

			wifi_host_wake_irq: wifi-host-wake-irq {
				rockchip,pins = <1 RK_PA7 RK_FUNC_GPIO &pcfg_pull_down>;
				phandle = <0x99>;
			};
		};

		wireless-bluetooth {

			uart2m1_gpios: uart2m1-gpios {
				rockchip,pins = <1 RK_PB2 RK_FUNC_GPIO &pcfg_pull_none>;
				phandle = <0x98>;
			};
		};
	};

	acodec_sound: acodec-sound {
		status = "okay";
		compatible = "simple-audio-card";
		simple-audio-card,name = "rk3528-acodec";
		simple-audio-card,format = "i2s";
		simple-audio-card,mclk-fs = <256>;
		phandle = <0x1aa>;

		simple-audio-card,cpu {
			sound-dai = <&sai2>;
		};

		simple-audio-card,codec {
			sound-dai = <&acodec>;
		};
	};

	fd655_dev {
		compatible = "rockchip,fd655_dev";
		status = "okay";
		clk_pin = <0x84 0x13 0x00>;
		dat_pin = <0x84 0x14 0x00>;
	};

	adc_keys: adc-keys {
		status = "okay";
		compatible = "adc-keys";
		io-channels = <&saradc 1>;
		io-channel-names = "buttons";
		keyup-threshold-microvolt = <1800000>;
		poll-interval = <100>;
		phandle = <0x1ab>;

		vol-up-key {
			label = "volume up";
			linux,code = <KEY_VOLUMEUP>;
			press-threshold-microvolt = <1750>;
		};
	};

	dc_12v: dc-12v {
		compatible = "regulator-fixed";
		regulator-name = "dc_12v";
		regulator-always-on;
		regulator-boot-on;
		regulator-min-microvolt = <12000000>;
		regulator-max-microvolt = <12000000>;
		phandle = <0x8d>;
	};

	leds: gpio-leds {
		compatible = "gpio-leds";
		phandle = <0x1ac>;

		pwr-wifi {
			gpios = <&gpio1 6 GPIO_ACTIVE_HIGH>;
			linux,default-trigger = "none";
			default-state = "on";
		};
	};

	hdmi_sound: hdmi-sound {
		compatible = "rockchip,hdmi";
		rockchip,mclk-fs = <128>;
		rockchip,card-name = "rockchip,hdmi";
		rockchip,cpu = <&sai3>;
		rockchip,codec = <&hdmi>;
		rockchip,jack-det;
		phandle = <0x1ad>;
	};

	pdmics: dummy-codec {
		status = "disabled";
		compatible = "rockchip,dummy-codec";
		#sound-dai-cells = <0>;
		phandle = <0x8a>;
	};

	pdm_mic_array: pdm-mic-array {
		status = "disabled";
		compatible = "simple-audio-card";
		simple-audio-card,name = "rockchip,pdm-mic-array";
		phandle = <0x1ae>;

		simple-audio-card,cpu {
			sound-dai = <&pdm>;
		};

		simple-audio-card,codec {
			sound-dai = <&pdmics>;
		};
	};

	spdif-sound {
		status = "okay";
		compatible = "simple-audio-card";
		simple-audio-card,name = "ROCKCHIP,SPDIF";
		simple-audio-card,mclk-fs = <128>;

		simple-audio-card,cpu {
			sound-dai = <&spdif_8ch>;
		};

		simple-audio-card,codec {
			sound-dai = <&spdif_out>;
		};
	};

	spdif_out: spdif-out {
		status = "okay";
		compatible = "linux,spdif-dit";
		#sound-dai-cells = <0>;
		phandle = <0x8c>;
	};

	vcc5v0_sys: vcc5v0-sys {
		compatible = "regulator-fixed";
		regulator-name = "vcc5v0_sys";
		regulator-always-on;
		regulator-boot-on;
		regulator-min-microvolt = <5000000>;
		regulator-max-microvolt = <5000000>;
		vin-supply = <&dc_12v>;
		phandle = <0x8e>;
	};

	vcc5v0_host: vcc5v0-host-regulator {
		compatible = "regulator-fixed";
		regulator-name = "vcc5v0_host";
		regulator-boot-on;
		regulator-always-on;
		regulator-min-microvolt = <5000000>;
		regulator-max-microvolt = <5000000>;
		enable-active-high;
		gpio = <&gpio4 13 GPIO_ACTIVE_HIGH>;
		vin-supply = <&vcc5v0_sys>;
		pinctrl-names = "default";
		pinctrl-0 = <&vcc5v0_host_en>;
		phandle = <0x76>;
	};

	vcc5v0_otg: vcc5v0-otg-regulator {
		compatible = "regulator-fixed";
		regulator-name = "vcc5v0_otg";
		regulator-min-microvolt = <5000000>;
		regulator-max-microvolt = <5000000>;
		enable-active-high;
		gpio = <&gpio4 17 GPIO_ACTIVE_HIGH>;
		vin-supply = <&vcc5v0_sys>;
		pinctrl-names = "default";
		pinctrl-0 = <&vcc5v0_otg_en>;
		phandle = <0x75>;
	};

	vccio_sd: vccio-sd {
		compatible = "regulator-gpio";
		regulator-name = "vccio_sd";
		regulator-min-microvolt = <1800000>;
		regulator-max-microvolt = <3300000>;
		gpios = <&gpio4 14 GPIO_ACTIVE_HIGH>;
		vin-supply = <&vcc5v0_sys>;
		states = <1800000 0 3300000 1>;
		phandle = <0x73>;
	};

	vdd_logic: vdd-logic {
		compatible = "pwm-regulator";
		pwms = <&pwm2 0 5000 1>;
		regulator-name = "vdd_logic";
		regulator-min-microvolt = <705000>;
		regulator-max-microvolt = <1006000>;
		regulator-init-microvolt = <900000>;
		regulator-always-on;
		regulator-boot-on;
		regulator-settling-time-up-us = <250>;
		pwm-supply = <&vcc5v0_sys>;
		status = "okay";
		phandle = <0x18>;
	};

	vdd_cpu: vdd-cpu {
		compatible = "pwm-regulator";
		pwms = <&pwm7 0 5000 1>;
		regulator-name = "vdd_cpu";
		regulator-min-microvolt = <746000>;
		regulator-max-microvolt = <1201000>;
		regulator-init-microvolt = <953000>;
		regulator-always-on;
		regulator-boot-on;
		regulator-settling-time-up-us = <250>;
		pwm-supply = <&vcc5v0_sys>;
		status = "okay";
		phandle = <0x0a>;
	};

	vdd_gpu: vdd-gpu {
		compatible = "pwm-regulator";
		pwms = <&pwm4 0 5000 1>;
		regulator-name = "vdd_gpu";
		regulator-min-microvolt = <705000>;
		regulator-max-microvolt = <1148000>;
		regulator-init-microvolt = <900000>;
		regulator-always-on;
		regulator-boot-on;
		regulator-settling-time-up-us = <250>;
		pwm-supply = <&vcc5v0_sys>;
		status = "okay";
		phandle = <0x28>;
	};

	vdd_0v9_s3: vdd-0v9-s3 {
		compatible = "regulator-fixed";
		regulator-name = "vdd_0v9_s3";
		regulator-always-on;
		regulator-boot-on;
		regulator-min-microvolt = <900000>;
		regulator-max-microvolt = <900000>;
		vin-supply = <&vcc5v0_sys>;
		phandle = <0x1af>;
	};

	vdd_1v8_s3: vdd-1v8-s3 {
		compatible = "regulator-fixed";
		regulator-name = "vdd_1v8_s3";
		regulator-always-on;
		regulator-boot-on;
		regulator-min-microvolt = <1800000>;
		regulator-max-microvolt = <1800000>;
		vin-supply = <&vcc5v0_sys>;
		phandle = <0x57>;
	};

	vcc_3v3_s3: vcc-3v3-s3 {
		compatible = "regulator-fixed";
		regulator-name = "vcc_3v3_s3";
		regulator-always-on;
		regulator-boot-on;
		regulator-min-microvolt = <3300000>;
		regulator-max-microvolt = <3300000>;
		vin-supply = <&vcc5v0_sys>;
		phandle = <0x94>;
	};

	vcc_sd: vcc-sd {
		compatible = "regulator-fixed";
		gpio = <&gpio4 1 GPIO_ACTIVE_LOW>;
		regulator-name = "vcc_sd";
		regulator-min-microvolt = <3300000>;
		regulator-max-microvolt = <3300000>;
		vin-supply = <&vcc_3v3_s3>;
		phandle = <0x74>;
	};

	vcc_ddr_s3: vcc-ddr-s3 {
		compatible = "regulator-fixed";
		regulator-name = "vcc_ddr_s3";
		regulator-always-on;
		regulator-boot-on;
		regulator-min-microvolt = <1200000>;
		regulator-max-microvolt = <1200000>;
		vin-supply = <&vcc5v0_sys>;
		phandle = <0x1b0>;
	};

	sdio_pwrseq: sdio-pwrseq {
		compatible = "mmc-pwrseq-simple";
		pinctrl-names = "default";
		pinctrl-0 = <&wifi_enable_h>, <&clkm1_32k_out>;
		reset-gpios = <&gpio4 4 GPIO_ACTIVE_LOW>;
		phandle = <0x6b>;
	};

	wireless_bluetooth: wireless-bluetooth {
		compatible = "bluetooth-platdata";
		uart_rts_gpios = <&gpio1 10 GPIO_ACTIVE_LOW>;
		pinctrl-names = "default", "rts_gpio";
		pinctrl-0 = <&uart2m1_rtsn>;
		pinctrl-1 = <&uart2m1_gpios>;
		BT,reset_gpio = <&gpio1 17 GPIO_ACTIVE_HIGH>;
		BT,wake_gpio = <&gpio1 12 GPIO_ACTIVE_HIGH>;
		BT,wake_host_irq = <&gpio1 18 GPIO_ACTIVE_HIGH>;
		status = "okay";
		phandle = <0x1b1>;
	};

	wireless_wlan: wireless-wlan {
		compatible = "wlan-platdata";
		rockchip,grf = <&grf>;
		wifi_chip_type = "ap6275s";
		pinctrl-names = "default";
		pinctrl-0 = <&wifi_host_wake_irq>;
		WIFI,host_wake_irq = <&gpio1 7 GPIO_ACTIVE_HIGH>;
		status = "okay";
		phandle = <0x1b2>;
	};

	chosen: chosen {
		bootargs = "earlycon=uart8250,mmio32,0xff9f0000 console=ttyFIQ0 driver_async_probe=dwmmc_rockchip,rockchip-drm drm_kms_helper.fbdev_emulation=0";
		phandle = <0x1b3>;
	};

	fiq-debugger {
		compatible = "rockchip,fiq-debugger";
		rockchip,serial-id = <0x00>;
		rockchip,wake-irq = <0x00>;
		rockchip,irq-mode-enable = <0x01>;
		rockchip,baudrate = <1500000>;
		interrupts = <GIC_SPI 186 IRQ_TYPE_LEVEL_HIGH>;
		pinctrl-names = "default";
		pinctrl-0 = <&uart0m0_xfer>;
		status = "okay";
	};

	reserved_memory: reserved-memory {
		#address-cells = <2>;
		#size-cells = <2>;
		ranges;
		phandle = <0x1b4>;

		cma {
			compatible = "shared-dma-pool";
			reusable;
			size = <0x00 0x800000>;
			linux,cma-default;
		};

		drm_logo: drm-logo@00000000 {
			compatible = "rockchip,drm-logo";
			reg = <0x00 0x00 0x00 0x00>;
			phandle = <0x13>;
		};

		drm_cubic_lut: drm-cubic-lut@00000000 {
			compatible = "rockchip,drm-cubic-lut";
			reg = <0x00 0x00 0x00 0x00>;
			phandle = <0x14>;
		};

		ramoops: ramoops@110000 {
			compatible = "ramoops";
			reg = <0x00 0x110000 0x00 0xe0000>;
			boot-log-size = <0x8000>;
			boot-log-count = <1>;
			console-size = <0x80000>;
			pmsg-size = <0x30000>;
			ftrace-size = <0x00>;
			record-size = <0x14000>;
			phandle = <0x1b5>;
		};
	};
};
